/**
 * @cliArgs --device "J742S2" --part "Default" --package "AND_6" --context "r5fss0-0" --product "J742S2_VISION_APPS@01.00.00"
 * @versions {"tool":"1.26.2+4477"}
 */

/**
 * Import the modules used in this configuration.
 */
const default_linker  = scripting.addModule("/memory_configurator/default_linker", {}, false);
const default_linker1 = default_linker.addInstance();
const rat_cfg         = scripting.addModule("/memory_configurator/rat_cfg", {}, false);
const rat_cfg1        = rat_cfg.addInstance();
const rat_cfg2        = rat_cfg.addInstance();
const region          = scripting.addModule("/memory_configurator/region", {}, false);
const region1         = region.addInstance();

/**
 * Write custom configuration values to the imported modules.
 */
default_linker1.$name = "memory_configurator_default_linker0";

rat_cfg1.$name      = "MAIN_OCRAM_MCU2_0_RAT";
rat_cfg1.localAddr  = 0x60000000;
rat_cfg1.systemAddr = 0x4F02000000;
rat_cfg1.size       = 18;

rat_cfg2.$name      = "DDR_SHARED_MEM_RAT";
rat_cfg2.localAddr  = 0xC0000000;
rat_cfg2.systemAddr = 0x900000000;

region1.$name                                = "MEMORY_REGION_CONFIGURATION0";
region1.memory_region.create(23);
region1.memory_region[0].$name               = "R5F_TCMA_VECS";
region1.memory_region[0].size                = 0x40;
region1.memory_region[0].auto                = false;
region1.memory_region[0].attributes          = ["X"];
region1.memory_region[1].$name               = "R5F_TCMA";
region1.memory_region[1].size                = 0x7FC0;
region1.memory_region[1].auto                = false;
region1.memory_region[1].manualStartAddress  = 0x40;
region1.memory_region[1].attributes          = ["R","W","X"];
region1.memory_region[2].type                = "TCMB_R5F";
region1.memory_region[2].$name               = "R5F_TCMB0";
region1.memory_region[2].size                = 0x8000;
region1.memory_region[2].auto                = false;
region1.memory_region[2].attributes          = ["R","W","X"];
region1.memory_region[3].type                = "OCRAM_SHRAED_ALL";
region1.memory_region[3].$name               = "MAIN_OCRAM_MCU2_0";
region1.memory_region[3].size                = 0x40000;
region1.memory_region[3].auto                = false;
region1.memory_region[3].attributes          = ["R","W","X"];
region1.memory_region[4].type                = "DDR_LOW_ALL";
region1.memory_region[4].$name               = "DDR_MCU2_0_IPC";
region1.memory_region[4].size                = 0x100000;
region1.memory_region[4].auto                = false;
region1.memory_region[4].manualStartAddress  = 0xA2000000;
region1.memory_region[4].attributes          = ["R","W","X"];
region1.memory_region[5].type                = "DDR_LOW_ALL";
region1.memory_region[5].$name               = "DDR_MCU2_0_RESOURCE_TABLE";
region1.memory_region[5].size                = 0x400;
region1.memory_region[5].auto                = false;
region1.memory_region[5].manualStartAddress  = 0xA2100000;
region1.memory_region[5].attributes          = ["R","W","X"];
region1.memory_region[6].type                = "DDR_LOW_ALL";
region1.memory_region[6].$name               = "DDR_MCU2_0";
region1.memory_region[6].size                = 0x2EFFC00;
region1.memory_region[6].auto                = false;
region1.memory_region[6].manualStartAddress  = 0xA2100400;
region1.memory_region[6].attributes          = ["R","W","X"];
region1.memory_region[7].type                = "DDR_LOW_ALL";
region1.memory_region[7].$name               = "IPC_VRING_MEM";
region1.memory_region[7].size                = 0x3000000;
region1.memory_region[7].auto                = false;
region1.memory_region[7].manualStartAddress  = 0xAC000000;
region1.memory_region[7].attributes          = ["R","W"];
region1.memory_region[7].isShared            = true;
region1.memory_region[7].shared_cores        = ["c71ss0-0","c71ss1-0","c71ss2-0","mcu-r5fss0-0","r5fss0-1","r5fss1-0","r5fss1-1","r5fss2-0","r5fss2-1"];
region1.memory_region[8].type                = "DDR_LOW_ALL";
region1.memory_region[8].$name               = "APP_LOG_MEM";
region1.memory_region[8].size                = 0x40000;
region1.memory_region[8].auto                = false;
region1.memory_region[8].manualStartAddress  = 0xAF000000;
region1.memory_region[8].attributes          = ["R","W"];
region1.memory_region[8].isShared            = true;
region1.memory_region[8].shared_cores        = ["c71ss0-0","c71ss1-0","c71ss2-0","mcu-r5fss0-0","r5fss0-1","r5fss1-0","r5fss1-1","r5fss2-0","r5fss2-1"];
region1.memory_region[9].type                = "DDR_LOW_ALL";
region1.memory_region[9].$name               = "TIOVX_OBJ_DESC_MEM_HOST0";
region1.memory_region[9].size                = 0x940000;
region1.memory_region[9].auto                = false;
region1.memory_region[9].manualStartAddress  = 0xAF040000;
region1.memory_region[9].attributes          = ["R","W"];
region1.memory_region[9].isShared            = true;
region1.memory_region[9].shared_cores        = ["c71ss0-0","c71ss1-0","c71ss2-0","mcu-r5fss0-0","r5fss0-1","r5fss1-0","r5fss1-1","r5fss2-0","r5fss2-1"];
region1.memory_region[10].type               = "DDR_LOW_ALL";
region1.memory_region[10].$name              = "TIOVX_OBJ_DESC_MEM_HOST1";
region1.memory_region[10].size               = 0x940000;
region1.memory_region[10].auto               = false;
region1.memory_region[10].manualStartAddress = 0xAF980000;
region1.memory_region[10].attributes         = ["R","W"];
region1.memory_region[10].isShared           = true;
region1.memory_region[10].shared_cores       = ["c71ss0-0","c71ss1-0","c71ss2-0","mcu-r5fss0-0","r5fss0-1","r5fss1-0","r5fss1-1","r5fss2-0","r5fss2-1"];
region1.memory_region[11].type               = "DDR_LOW_ALL";
region1.memory_region[11].$name              = "TIOVX_OBJ_DESC_MEM_HOST2";
region1.memory_region[11].size               = 0x940000;
region1.memory_region[11].auto               = false;
region1.memory_region[11].manualStartAddress = 0xB02C0000;
region1.memory_region[11].attributes         = ["R","W"];
region1.memory_region[11].isShared           = true;
region1.memory_region[11].shared_cores       = ["c71ss0-0","c71ss1-0","c71ss2-0","mcu-r5fss0-0","r5fss0-1","r5fss1-0","r5fss1-1","r5fss2-0","r5fss2-1"];
region1.memory_region[12].type               = "DDR_LOW_ALL";
region1.memory_region[12].$name              = "APP_FILEIO_MEM";
region1.memory_region[12].size               = 0x400000;
region1.memory_region[12].auto               = false;
region1.memory_region[12].manualStartAddress = 0xB1000000;
region1.memory_region[12].attributes         = ["R","W"];
region1.memory_region[12].isShared           = true;
region1.memory_region[12].shared_cores       = ["c71ss0-0","c71ss1-0","c71ss2-0","mcu-r5fss0-0","r5fss0-1","r5fss1-0","r5fss1-1","r5fss2-0","r5fss2-1"];
region1.memory_region[13].type               = "DDR_LOW_ALL";
region1.memory_region[13].$name              = "DDR_MCU2_0_LOCAL_HEAP";
region1.memory_region[13].size               = 0x600000;
region1.memory_region[13].auto               = false;
region1.memory_region[13].manualStartAddress = 0xB9000000;
region1.memory_region[13].attributes         = ["R","W","X"];
region1.memory_region[14].type               = "DDR_LOW_ALL";
region1.memory_region[14].$name              = "DDR_MCU2_0_VISS_CONFIG_HEAP";
region1.memory_region[14].size               = 0x200000;
region1.memory_region[14].auto               = false;
region1.memory_region[14].manualStartAddress = 0xB9600000;
region1.memory_region[14].attributes         = ["R","W","X"];
region1.memory_region[15].type               = "DDR_LOW_ALL";
region1.memory_region[15].$name              = "INTERCORE_ETH_DESC_MEM";
region1.memory_region[15].size               = 0x800000;
region1.memory_region[15].auto               = false;
region1.memory_region[15].manualStartAddress = 0xBC000000;
region1.memory_region[15].attributes         = ["R","W"];
region1.memory_region[15].isShared           = true;
region1.memory_region[15].shared_cores       = ["c71ss0-0","c71ss1-0","c71ss2-0","mcu-r5fss0-0","r5fss0-1","r5fss1-0","r5fss1-1","r5fss2-0","r5fss2-1"];
region1.memory_region[16].type               = "DDR_LOW_ALL";
region1.memory_region[16].$name              = "INTERCORE_ETH_DATA_MEM";
region1.memory_region[16].size               = 0x1800000;
region1.memory_region[16].auto               = false;
region1.memory_region[16].manualStartAddress = 0xBC800000;
region1.memory_region[16].attributes         = ["R","W"];
region1.memory_region[16].isShared           = true;
region1.memory_region[16].shared_cores       = ["c71ss0-0","c71ss1-0","c71ss2-0","mcu-r5fss0-0","r5fss0-1","r5fss1-0","r5fss1-1","r5fss2-0","r5fss2-1"];
region1.memory_region[17].type               = "DDR_LOW_ALL";
region1.memory_region[17].$name              = "DDR_SHARED_MEM";
region1.memory_region[17].size               = 0x20000000;
region1.memory_region[17].auto               = false;
region1.memory_region[17].manualStartAddress = 0xC0000000;
region1.memory_region[17].attributes         = ["R","W","X"];
region1.memory_region[17].isShared           = true;
region1.memory_region[17].shared_cores       = ["c71ss0-0","c71ss1-0","c71ss2-0","mcu-r5fss0-0","r5fss0-1","r5fss1-0","r5fss1-1","r5fss2-0","r5fss2-1"];
region1.memory_region[17].allowOverlap       = true;
region1.memory_region[18].type               = "DDR_LOW_ALL";
region1.memory_region[18].$name              = "DDR_SHARED_MEM_HOST0";
region1.memory_region[18].size               = 0xAAAA000;
region1.memory_region[18].auto               = false;
region1.memory_region[18].manualStartAddress = 0xC0000000;
region1.memory_region[18].attributes         = ["R","W","X"];
region1.memory_region[18].isShared           = true;
region1.memory_region[18].shared_cores       = ["c71ss0-0","c71ss1-0","c71ss2-0","mcu-r5fss0-0","r5fss0-1","r5fss1-0","r5fss1-1","r5fss2-0","r5fss2-1"];
region1.memory_region[19].type               = "DDR_LOW_ALL";
region1.memory_region[19].$name              = "DDR_SHARED_MEM_HOST1";
region1.memory_region[19].size               = 0xAAAA000;
region1.memory_region[19].auto               = false;
region1.memory_region[19].manualStartAddress = 0xCAAAA000;
region1.memory_region[19].attributes         = ["R","W","X"];
region1.memory_region[19].isShared           = true;
region1.memory_region[19].shared_cores       = ["c71ss0-0","c71ss1-0","c71ss2-0","mcu-r5fss0-0","r5fss0-1","r5fss1-0","r5fss1-1","r5fss2-0","r5fss2-1"];
region1.memory_region[20].type               = "DDR_LOW_ALL";
region1.memory_region[20].$name              = "DDR_SHARED_MEM_HOST2";
region1.memory_region[20].size               = 0xAAAA000;
region1.memory_region[20].auto               = false;
region1.memory_region[20].manualStartAddress = 0xD5554000;
region1.memory_region[20].attributes         = ["R","W","X"];
region1.memory_region[20].isShared           = true;
region1.memory_region[20].shared_cores       = ["c71ss0-0","c71ss1-0","c71ss2-0","mcu-r5fss0-0","r5fss0-1","r5fss1-0","r5fss1-1","r5fss2-0","r5fss2-1"];
region1.memory_region[21].type               = "DDR_LOW_ALL";
region1.memory_region[21].$name              = "TIOVX_LOG_RT_MEM";
region1.memory_region[21].auto               = false;
region1.memory_region[21].manualStartAddress = 0xB1400000;
region1.memory_region[21].size               = 0xC00000;
region1.memory_region[21].isShared           = true;
region1.memory_region[21].shared_cores       = ["c71ss0-0","c71ss1-0","c71ss2-0","mcu-r5fss0-0","r5fss0-1","r5fss1-0","r5fss1-1","r5fss2-0","r5fss2-1"];
region1.memory_region[22].type               = "DDR_LOW_ALL";
region1.memory_region[22].$name              = "DDR_MCU2_0_VISS_READBACK_ADDR";
region1.memory_region[22].size               = 0x200000;
region1.memory_region[22].auto               = false;
region1.memory_region[22].manualStartAddress = 0xB0C00000;
