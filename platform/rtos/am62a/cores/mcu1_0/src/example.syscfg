/**
 * @cliArgs --device "AM62Ax" --part "Default" --package "AMB" --context "mcu-r5fss0-0" --product "MCU_PLUS_SDK@07.03.01"
 * @versions {"tool":"1.23.0+4000"}
 */

/**
 * Import the modules used in this configuration.
 */

const udma       = scripting.addModule("/drivers/udma/udma", {}, false);
const udma1      = udma.addInstance();

const i2c        = scripting.addModule("/drivers/i2c/i2c", {}, false);
const i2c1       = i2c.addInstance();
const i2c2       = i2c.addInstance();

const clock      = scripting.addModule("/kernel/dpl/clock");
const debug_log  = scripting.addModule("/kernel/dpl/debug_log");
const mpu_armv7  = scripting.addModule("/kernel/dpl/mpu_armv7", {}, false);
const mpu_armv71 = mpu_armv7.addInstance();
const mpu_armv72 = mpu_armv7.addInstance();
const mpu_armv73 = mpu_armv7.addInstance();
const mpu_armv74 = mpu_armv7.addInstance();
const mpu_armv75 = mpu_armv7.addInstance();
const mpu_armv76 = mpu_armv7.addInstance();
const mpu_armv77 = mpu_armv7.addInstance();
const mpu_armv78 = mpu_armv7.addInstance();
const mpu_armv79 = mpu_armv7.addInstance();
const mpu_armv710 = mpu_armv7.addInstance();

/**
 * Write custom configuration values to the imported modules.
 */
debug_log.enableUartLog = true;
debug_log.uartLog.$name = "CONFIG_UART0";

i2c1.$name                      = "CONFIG_I2C2";
i2c1.useWakeupDomainPeripherals = false;
i2c1.enableIntr                 = false;
i2c1.I2C_child.$name            = "drivers_i2c_v0_i2c_v0_template0";
i2c1.I2C.$assign                = "I2C2";
i2c1.I2C.SCL.$suggestSolution   = "GPMC0_CSn2";
i2c1.I2C.SDA.$suggestSolution   = "GPMC0_CSn3";

i2c2.$name                      = "CONFIG_I2C1";
i2c2.useWakeupDomainPeripherals = false;
i2c2.enableIntr                 = false;
i2c2.I2C_child.$name            = "drivers_i2c_v0_i2c_v0_template1";
i2c2.I2C.$assign                = "I2C1";
i2c2.I2C.SCL.$suggestSolution   = "I2C1_SCL";
i2c2.I2C.SDA.$suggestSolution   = "I2C1_SDA";

mpu_armv71.allowExecute = false;
mpu_armv71.$name        = "REGISTER_REGION";
mpu_armv71.tex          = 0;
mpu_armv71.isCacheable  = false;
mpu_armv71.attributes   = "CUSTOM";
mpu_armv71.isBufferable = false;

mpu_armv72.$name       = "TCMA_VEC";
mpu_armv72.size        = 15;
mpu_armv72.attributes  = "CUSTOM";
mpu_armv72.tex         = 5;
mpu_armv72.isCacheable = false;

mpu_armv73.baseAddr    = 0x80000000;
mpu_armv73.size        = 31;
mpu_armv73.$name       = "DDR";
mpu_armv73.attributes  = "CUSTOM";
mpu_armv73.tex         = 5;

mpu_armv74.baseAddr     = 0x41010000;
mpu_armv74.size         = 15;
mpu_armv74.$name        = "TCMB";
mpu_armv74.attributes   = "CUSTOM";
mpu_armv74.isCacheable  = false;
mpu_armv74.isBufferable = false;
mpu_armv74.tex          = 4;

mpu_armv75.baseAddr    = 0x50000000;
mpu_armv75.$name       = "FSS_DAT";
mpu_armv75.size        = 27;
mpu_armv75.attributes  = "CUSTOM";
mpu_armv75.tex         = 5;
mpu_armv75.isCacheable = false;

mpu_armv76.baseAddr     = 0x9C800000;
mpu_armv76.size         = 20;
mpu_armv76.$name        = "DDR_DM_R5F_IPC";
mpu_armv76.attributes   = "CUSTOM";
mpu_armv76.tex          = 0;
mpu_armv76.isCacheable  = false;
mpu_armv76.isBufferable = false;
mpu_armv76.allowExecute = false;

mpu_armv77.baseAddr     = 0xA0000000;
mpu_armv77.allowExecute = false;
mpu_armv77.$name        = "IPC_VRING_MEM";
mpu_armv77.attributes   = "CUSTOM";
mpu_armv77.isCacheable  = false;
mpu_armv77.isBufferable = false;
mpu_armv77.tex          = 0;
mpu_armv77.size         = 24;

mpu_armv78.$name        = "APP_LOG_MEM";
mpu_armv78.allowExecute = false;
mpu_armv78.attributes   = "CUSTOM";
mpu_armv78.isCacheable  = false;
mpu_armv78.isBufferable = false;
mpu_armv78.tex          = 0;
mpu_armv78.baseAddr     = 0xA1000000;
mpu_armv78.size         = 24;

mpu_armv79.$name        = "APP_FILEIO_MEM";
mpu_armv79.allowExecute = false;
mpu_armv79.attributes   = "CUSTOM";
mpu_armv79.isCacheable  = false;
mpu_armv79.isBufferable = false;
mpu_armv79.tex          = 0;
mpu_armv79.baseAddr     = 0xA2000000;
mpu_armv79.size         = 24;

mpu_armv710.$name        = "DDR_DM_R5F_VISS_CONFIG_HEAP";
mpu_armv710.size         = 22;
mpu_armv710.attributes   = "CUSTOM";
mpu_armv710.tex          = 7;
mpu_armv710.isBufferable = false;
mpu_armv710.baseAddr     = 0xADC00000;

/**
 * Pinmux solution for unlocked pins/peripherals. This ensures that minor changes to the automatic solver in a future
 * version of the tool will not impact the pinmux you originally saw.  These lines can be completely deleted in order to
 * re-solve from scratch.
 */
debug_log.uartLog.WKUP_UART.$suggestSolution     = "WKUP_USART0";
debug_log.uartLog.WKUP_UART.RXD.$suggestSolution = "ball.C9";
debug_log.uartLog.WKUP_UART.TXD.$suggestSolution = "ball.E9";
