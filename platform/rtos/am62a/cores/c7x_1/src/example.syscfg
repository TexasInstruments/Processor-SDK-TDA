/**
 * @cliArgs --device "AM62Ax" --package "AMB" --part "Default" --context "c75ss0-0" --product "MCU_PLUS_SDK@07.03.01"
 * @versions {"tool":"1.20.0+3587"}
 */

/**
 * Import the modules used in this configuration.
 */
const debug_log   = scripting.addModule("/kernel/dpl/debug_log");
const mmu_armv8   = scripting.addModule("/kernel/dpl/mmu_armv8", {}, false);
const mmu_armv81  = mmu_armv8.addInstance();
const mmu_armv82  = mmu_armv8.addInstance();
const mmu_armv83  = mmu_armv8.addInstance();
const mmu_armv84  = mmu_armv8.addInstance();
const mmu_armv85  = mmu_armv8.addInstance();
const mmu_armv86  = mmu_armv8.addInstance();
const mmu_armv87  = mmu_armv8.addInstance();
const mmu_armv88  = mmu_armv8.addInstance();
const mmu_armv89  = mmu_armv8.addInstance();
const mmu_armv810 = mmu_armv8.addInstance();
const mmu_armv811 = mmu_armv8.addInstance();
const mmu_armv812 = mmu_armv8.addInstance();
const mmu_armv813 = mmu_armv8.addInstance();
const mmu_armv814 = mmu_armv8.addInstance();
const mmu_armv815 = mmu_armv8.addInstance();
const mmu_armv816 = mmu_armv8.addInstance();
const mmu_armv817 = mmu_armv8.addInstance();
const mmu_armv818 = mmu_armv8.addInstance();
const mmu_armv819 = mmu_armv8.addInstance();
const mmu_armv820 = mmu_armv8.addInstance();
const mmu_armv821 = mmu_armv8.addInstance();

/**
 * Write custom configuration values to the imported modules.
 */
mmu_armv81.size  = 0x20000000;
mmu_armv81.$name = "REGISTER_REGION_0";

mmu_armv82.vAddr = 0x20000000;
mmu_armv82.pAddr = 0x20000000;
mmu_armv82.size  = 0x20000000;
mmu_armv82.$name = "REGISTER_REGION_1";

mmu_armv83.vAddr = 0x40000000;
mmu_armv83.pAddr = 0x40000000;
mmu_armv83.size  = 0x20000000;
mmu_armv83.$name = "REGISTER_REGION_2";

mmu_armv84.vAddr = 0x60000000;
mmu_armv84.pAddr = 0x60000000;
mmu_armv84.size  = 0x10000000;
mmu_armv84.$name = "FSS0_DAT_REGION";

mmu_armv85.$name = "CONFIG_MMU_REGION0";
mmu_armv85.vAddr = 0x70000000;
mmu_armv85.pAddr = 0x70000000;
mmu_armv85.size  = 0x10000000;

mmu_armv86.vAddr = 0x7C200000;
mmu_armv86.pAddr = 0x7C200000;
mmu_armv86.size  = 0x100000;
mmu_armv86.$name = "CLEC";

mmu_armv87.vAddr = 0x7C400000;
mmu_armv87.pAddr = 0x7C400000;
mmu_armv87.size  = 0x100000;
mmu_armv87.$name = "DRU";

mmu_armv88.vAddr     = 0x7E000000;
mmu_armv88.pAddr     = 0x7E000000;
mmu_armv88.$name      = "L2RAM_C7x_1_MAIN";
mmu_armv88.size      = 0x100000;
mmu_armv88.attribute  = "MAIR7";

mmu_armv89.vAddr     = 0x7F000000;
mmu_armv89.pAddr     = 0x7F000000;
mmu_armv89.size      = 0x03C000;
mmu_armv89.$name      = "L2RAM_C7x_1_AUX";
mmu_armv89.attribute  = "MAIR7";

mmu_armv810.attribute = "MAIR7";
mmu_armv810.$name     = "DDR_C7x_1_DTS";
mmu_armv810.vAddr     = 0x99900000;
mmu_armv810.pAddr     = 0x99900000;
mmu_armv810.size      = 0xF00000;

mmu_armv811.$name     = "DDR_SHARED_MEM";
mmu_armv811.vAddr     = 0xA3000000;
mmu_armv811.pAddr     = 0xA3000000;
mmu_armv811.size      = 0xAC00000;
mmu_armv811.attribute = "MAIR7";

mmu_armv812.vAddr     = 0xB2000000;
mmu_armv812.pAddr     = 0xB2000000;
mmu_armv812.size      = 0x7000000;
mmu_armv812.$name     = "DDR_C7X_1_LOCAL_HEAP";
mmu_armv812.attribute = "MAIR7";

mmu_armv813.$name     = "DDR_C7X_1_SCRATCH";
mmu_armv813.attribute = "MAIR7";
mmu_armv813.vAddr     = 0xB9000000;
mmu_armv813.pAddr     = 0xB9000000;
mmu_armv813.size      = 0x7000000;

mmu_armv814.attribute = "MAIR4";
mmu_armv814.vAddr     = 0xA1000000;
mmu_armv814.pAddr     = 0xA1000000;
mmu_armv814.size      = 0x040000;
mmu_armv814.$name     = "APP_LOG_MEM";

mmu_armv815.$name     = "APP_FILEIO_MEM";
mmu_armv815.vAddr     = 0xA2000000;
mmu_armv815.pAddr     = 0xA2000000;
mmu_armv815.size      = 0x400000;
mmu_armv815.attribute = "MAIR4";

mmu_armv816.$name     = "TIOVX_OBJ_DESC_MEM";
mmu_armv816.vAddr     = 0xA1040000;
mmu_armv816.pAddr     = 0xA1040000;
mmu_armv816.size      = 0xFC0000;
mmu_armv816.attribute = "MAIR4";

mmu_armv817.$name     = "IPC_VRING_MEM";
mmu_armv817.vAddr     = 0xA0000000;
mmu_armv817.pAddr     = 0xA0000000;
mmu_armv817.size      = 0x1000000;
mmu_armv817.attribute = "MAIR4";

mmu_armv818.$name     = "DDR_C7x_1_IPC";
mmu_armv818.vAddr     = 0x99800000;
mmu_armv818.pAddr     = 0x99800000;
mmu_armv818.size      = 0x100000;
mmu_armv818.attribute = "MAIR4";

mmu_armv819.vAddr     = 0xA2400000;
mmu_armv819.pAddr     = 0xA2400000;
mmu_armv819.size      = 0xC00000;
mmu_armv819.attribute = "MAIR4";
mmu_armv819.$name     = "TIOVX_LOG_RT_MEM";

mmu_armv820.$name     = "DDR_C7X_1_LOCAL_HEAP_NON_CACHEABLE";
mmu_armv820.vAddr     = 0xB0000000;
mmu_armv820.size      = 0x1000000;
mmu_armv820.pAddr     = 0xB0000000;
mmu_armv820.attribute = "MAIR4";

mmu_armv821.$name     = "DDR_C7X_1_SCRATCH_NON_CACHEABLE";
mmu_armv821.vAddr     = 0xB1000000;
mmu_armv821.pAddr     = 0xB1000000;
mmu_armv821.size      = 0x1000000;
mmu_armv821.attribute = "MAIR4";
