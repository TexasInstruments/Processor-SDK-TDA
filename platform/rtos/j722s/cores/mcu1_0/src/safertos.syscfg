/**
 * @cliArgs --device "J722S_TDA4VEN_TDA4AEN_AM67" --part "Default" --package "AMW" --context "wkup-r5fss0-0" --product "MCU_PLUS_SDK@07.03.01"
 * @versions {"tool":"1.26.2+4477"}
 */

/**
 * Import the modules used in this configuration.
 */
const addr_translate  = scripting.addModule("/kernel/dpl/addr_translate", {}, false);
const addr_translate1 = addr_translate.addInstance();
const clock           = scripting.addModule("/kernel/dpl/clock");
const debug_log       = scripting.addModule("/kernel/dpl/debug_log");
const mpu_armv7       = scripting.addModule("/kernel/dpl/mpu_armv7", {}, false);
const mpu_armv71      = mpu_armv7.addInstance();
const mpu_armv72      = mpu_armv7.addInstance();
const mpu_armv73      = mpu_armv7.addInstance();
const mpu_armv74      = mpu_armv7.addInstance();
const mpu_armv75      = mpu_armv7.addInstance();
const mpu_armv76      = mpu_armv7.addInstance();
const mpu_armv77      = mpu_armv7.addInstance();
const mpu_armv78      = mpu_armv7.addInstance();
const default_linker  = scripting.addModule("/memory_configurator/default_linker", {}, false);
const default_linker1 = default_linker.addInstance();
const region          = scripting.addModule("/memory_configurator/region", {}, false);
const region1         = region.addInstance();

/**
 * Write custom configuration values to the imported modules.
 */
addr_translate1.$name      = "CONFIG_ADDR_TRANSLATE_REGION0";
addr_translate1.localAddr  = 0xC0000000;
addr_translate1.systemAddr = 0x900000000;

debug_log.enableLogZoneWarning = false;
debug_log.enableLogZoneError   = false;
debug_log.enableUartLog        = true;
debug_log.uartLog.$name        = "CONFIG_UART0";
debug_log.uartLog.intrEnable   = "DISABLE";

mpu_armv71.size         = 31;
mpu_armv71.attributes   = "Device";
mpu_armv71.allowExecute = false;
mpu_armv71.$name        = "CONFIG_MPU_REGISTER";

mpu_armv72.size       = 15;
mpu_armv72.$name      = "CONFIG_MPU_TCMA";
mpu_armv72.attributes = "NonCached";

mpu_armv73.baseAddr   = 0x41010000;
mpu_armv73.size       = 15;
mpu_armv73.$name      = "CONFIG_MPU_TCMB";
mpu_armv73.attributes = "NonCached";

mpu_armv74.baseAddr = 0x60000000;
mpu_armv74.size     = 26;
mpu_armv74.$name    = "CONFIG_MPU_FLASH";

mpu_armv75.baseAddr = 0x79100000;
mpu_armv75.size     = 19;
mpu_armv75.$name    = "CONFIG_MPU_MCU_MSRAM";

mpu_armv76.baseAddr = 0x80000000;
mpu_armv76.size     = 31;
mpu_armv76.$name    = "CONFIG_MPU_DDR";

mpu_armv77.baseAddr     = 0xA0000000;
mpu_armv77.size         = 21;
mpu_armv77.$name        = "LINUX_VRING_AND_RESOURCE_TABLE";
mpu_armv77.allowExecute = false;
mpu_armv77.attributes   = "NonCached";

mpu_armv78.baseAddr     = 0xA4000000;
mpu_armv78.size         = 26;
mpu_armv78.$name        = "DDR_SHARED_MEM_NON_CACHE";
mpu_armv78.allowExecute = false;
mpu_armv78.attributes   = "NonCached";

default_linker1.$name = "memory_configurator_default_linker0";

region1.$name                                = "MEMORY_REGION_CONFIGURATION0";
region1.memory_region.create(9);
region1.memory_region[0].$name               = "R5F_TCMA_VECS";
region1.memory_region[0].size                = 0x40;
region1.memory_region[0].auto                = false;
region1.memory_region[0].attributes          = ["X"];
region1.memory_region[1].$name               = "R5F_TCMA";
region1.memory_region[1].size                = 0x7FC0;
region1.memory_region[1].auto                = false;
region1.memory_region[1].manualStartAddress  = 0x40;
region1.memory_region[1].attributes          = ["X"];
region1.memory_region[2].type                = "TCMB_R5F";
region1.memory_region[2].$name               = "R5F_TCMB0_VECS";
region1.memory_region[2].size                = 0x40;
region1.memory_region[2].auto                = false;
region1.memory_region[3].type                = "TCMB_R5F";
region1.memory_region[3].$name               = "R5F_TCMB0";
region1.memory_region[3].size                = 0x7FC0;
region1.memory_region[3].auto                = false;
region1.memory_region[3].manualStartAddress  = 0x41010040;
region1.memory_region[4].type                = "DDR_LOW_ALL";
region1.memory_region[4].$name               = "DDR_MCU1_0_IPC";
region1.memory_region[4].size                = 0x100000;
region1.memory_region[4].auto                = false;
region1.memory_region[4].manualStartAddress  = 0xA0000000;
region1.memory_region[5].type                = "DDR_LOW_ALL";
region1.memory_region[5].$name               = "DDR_MCU1_0_RESOURCE_TABLE";
region1.memory_region[5].size                = 0x400;
region1.memory_region[5].auto                = false;
region1.memory_region[5].manualStartAddress  = 0xA0100000;
region1.memory_region[6].type                = "DDR_LOW_ALL";
region1.memory_region[6].$name               = "DDR_MCU1_0_IPC_TRACE";
region1.memory_region[6].size                = 0xFFC00;
region1.memory_region[6].auto                = false;
region1.memory_region[6].manualStartAddress  = 0xA0100400;
region1.memory_region[7].type                = "DDR_LOW_ALL";
region1.memory_region[7].$name               = "DDR_MCU1_0";
region1.memory_region[7].size                = 0xE00000;
region1.memory_region[7].auto                = false;
region1.memory_region[7].manualStartAddress  = 0xA0200000;
region1.memory_region[8].type                = "DDR_LOW_ALL";
region1.memory_region[8].$name               = "DDR_MCU1_0_LOCAL_HEAP";
region1.memory_region[8].size                = 0x800000;
region1.memory_region[8].auto                = false;
region1.memory_region[8].manualStartAddress  = 0xB5000000;

/**
 * Pinmux solution for unlocked pins/peripherals. This ensures that minor changes to the automatic solver in a future
 * version of the tool will not impact the pinmux you originally saw.  These lines can be completely deleted in order to
 * re-solve from scratch.
 */
debug_log.uartLog.WKUP_UART.$suggestSolution     = "WKUP_USART0";
debug_log.uartLog.WKUP_UART.RXD.$suggestSolution = "WKUP_UART0_RXD";
debug_log.uartLog.WKUP_UART.TXD.$suggestSolution = "WKUP_UART0_TXD";
