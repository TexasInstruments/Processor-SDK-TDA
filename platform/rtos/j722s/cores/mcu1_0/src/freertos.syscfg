/**
 * @cliArgs --device "J722S_TDA4VEN_TDA4AEN_AM67" --package "AMW" --part "Default" --context "wkup-r5fss0-0" --product "MCU_PLUS_SDK@07.03.01"
 * @versions {"tool":"1.20.0+3562"}
 */

/**
 * Import the modules used in this configuration.
 */
const clock      = scripting.addModule("/kernel/dpl/clock");
const debug_log  = scripting.addModule("/kernel/dpl/debug_log");
const mpu_armv7  = scripting.addModule("/kernel/dpl/mpu_armv7", {}, false);
const mpu_armv71 = mpu_armv7.addInstance();
const mpu_armv72 = mpu_armv7.addInstance();
const mpu_armv73 = mpu_armv7.addInstance();
const mpu_armv74 = mpu_armv7.addInstance();
const mpu_armv75 = mpu_armv7.addInstance();
const mpu_armv76 = mpu_armv7.addInstance();
const mpu_armv77 = mpu_armv7.addInstance();
const mpu_armv78 = mpu_armv7.addInstance();
const mpu_armv79 = mpu_armv7.addInstance();
const mpu_armv710 = mpu_armv7.addInstance();
const mpu_armv711 = mpu_armv7.addInstance();
const mpu_armv712 = mpu_armv7.addInstance();
const mpu_armv713 = mpu_armv7.addInstance();
const addr_translate  = scripting.addModule("/kernel/dpl/addr_translate", {}, false);
const addr_translate1 = addr_translate.addInstance();

/**
 * Write custom configuration values to the imported modules.
 */
debug_log.enableSharedMemLog   = false;
debug_log.enableLogZoneWarning = false;
debug_log.enableLogZoneError   = false;

debug_log.enableUartLog        = true;
debug_log.uartLog.$name        = "CONFIG_UART0";
debug_log.uartLog.intrEnable   = "DISABLE";

mpu_armv71.baseAddr     = 0x0;
mpu_armv71.size         = 31; /* 2 GB */
mpu_armv71.attributes   = "Device";
mpu_armv71.allowExecute = false;
mpu_armv71.$name        = "CONFIG_MPU_REGISTER";

mpu_armv72.baseAddr     = 0x0;
mpu_armv72.size         = 15; /* 32 KB */
mpu_armv72.$name        = "CONFIG_MPU_TCMA";
mpu_armv72.allowExecute = true;
mpu_armv72.attributes   = "NonCached";

mpu_armv73.baseAddr     = 0x41010000;
mpu_armv73.size         = 15; /* 32 KB */
mpu_armv73.$name        = "CONFIG_MPU_TCMB";
mpu_armv73.allowExecute = true;
mpu_armv73.attributes   = "NonCached";

mpu_armv74.baseAddr     = 0x60000000;
mpu_armv74.size         = 26; /* 64 MB */
mpu_armv74.$name        = "CONFIG_MPU_FLASH";
mpu_armv74.allowExecute = true;

mpu_armv75.baseAddr     = 0x79100000;
mpu_armv75.size         = 19; /* 512 KB */
mpu_armv75.$name        = "CONFIG_MPU_MCU_MSRAM";
mpu_armv75.allowExecute = true;

mpu_armv76.baseAddr     = 0x80000000;
mpu_armv76.size         = 31; /* 2 GB */
mpu_armv76.$name        = "CONFIG_MPU_DDR";
mpu_armv76.allowExecute = true;

mpu_armv77.baseAddr            = 0xA0000000;
mpu_armv77.size                = 20;
mpu_armv77.$name               = "LINUX_VRING";
mpu_armv77.allowExecute        = false;
mpu_armv77.attributes          = "NonCached";

mpu_armv78.baseAddr            = 0xA0100000;
mpu_armv78.size                = 20;
mpu_armv78.allowExecute        = false;
mpu_armv78.$name               = "RESOURCE_TABLE_AND_TRACE";
mpu_armv78.attributes          = "NonCached";

mpu_armv79.baseAddr            = 0xA5000000;
mpu_armv79.size                = 24;
mpu_armv79.allowExecute        = false;
mpu_armv79.$name               = "IPC_VRING_MEM";
mpu_armv79.attributes          = "NonCached";

mpu_armv710.baseAddr           = 0xA6000000;
mpu_armv710.size               = 24;
mpu_armv710.allowExecute       = false;
mpu_armv710.$name              = "TIOVX_LOG_RT_MEM";
mpu_armv710.attributes         = "NonCached";

mpu_armv711.baseAddr           = 0xA7000000;
mpu_armv711.size               = 23;
mpu_armv711.allowExecute       = false;
mpu_armv711.$name              = "TIOVX_OBJ_DESC_MEM";
mpu_armv711.attributes         = "NonCached";

mpu_armv712.baseAddr           = 0xA7800000;
mpu_armv712.size               = 22;
mpu_armv712.allowExecute       = false;
mpu_armv712.$name              = "APP_FILEIO_MEM";
mpu_armv712.attributes         = "NonCached";

mpu_armv713.baseAddr           = 0xA7C00000;
mpu_armv713.size               = 18;
mpu_armv713.allowExecute       = false;
mpu_armv713.$name              = "APP_LOG_MEM";
mpu_armv713.attributes         = "NonCached";

/**
 * Pinmux solution for unlocked pins/peripherals. This ensures that minor changes to the automatic solver in a future
 * version of the tool will not impact the pinmux you originally saw.  These lines can be completely deleted in order to
 * re-solve from scratch.
 */
debug_log.uartLog.WKUP_UART.$suggestSolution     = "WKUP_USART0";
debug_log.uartLog.WKUP_UART.RXD.$suggestSolution = "WKUP_UART0_RXD";
debug_log.uartLog.WKUP_UART.TXD.$suggestSolution = "WKUP_UART0_TXD";

addr_translate1.$name      = "CONFIG_ADDR_TRANSLATE_REGION0";
addr_translate1.localAddr  = 0xC0000000;
addr_translate1.systemAddr = 0x900000000;
