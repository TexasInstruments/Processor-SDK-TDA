/**
 * @cliArgs --device "J722S_TDA4VEN_TDA4AEN_AM67" --part "Default" --package "AMW" --context "main-r5fss0-0" --product "MCU_PLUS_SDK@07.03.01"
 * @versions {"tool":"1.26.2+4477"}
 */

/**
 * Import the modules used in this configuration.
 */
const dss              = scripting.addModule("/drivers/dss/dss", {}, false);
const dss1             = dss.addInstance();
const dss2             = dss.addInstance();
const i2c              = scripting.addModule("/drivers/i2c/i2c", {}, false);
const i2c1             = i2c.addInstance();
const i2c2             = i2c.addInstance();
const udma             = scripting.addModule("/drivers/udma/udma", {}, false);
const udma1            = udma.addInstance();
const addr_translate   = scripting.addModule("/kernel/dpl/addr_translate", {}, false);
const addr_translate1  = addr_translate.addInstance();
const debug_log        = scripting.addModule("/kernel/dpl/debug_log");
const mpu_armv7        = scripting.addModule("/kernel/dpl/mpu_armv7", {}, false);
const mpu_armv71       = mpu_armv7.addInstance();
const mpu_armv72       = mpu_armv7.addInstance();
const mpu_armv73       = mpu_armv7.addInstance();
const mpu_armv74       = mpu_armv7.addInstance();
const mpu_armv75       = mpu_armv7.addInstance();
const mpu_armv76       = mpu_armv7.addInstance();
const mpu_armv77       = mpu_armv7.addInstance();
const mpu_armv78       = mpu_armv7.addInstance();
const mpu_armv79       = mpu_armv7.addInstance();
const mpu_armv710      = mpu_armv7.addInstance();
const mpu_armv711      = mpu_armv7.addInstance();
const mpu_armv712      = mpu_armv7.addInstance();
const mpu_armv713      = mpu_armv7.addInstance();
const mpu_armv714      = mpu_armv7.addInstance();
const mpu_armv715      = mpu_armv7.addInstance();
const default_linker   = scripting.addModule("/memory_configurator/default_linker", {}, false);
const default_linker1  = default_linker.addInstance();
const region           = scripting.addModule("/memory_configurator/region", {}, false);
const region1          = region.addInstance();
const enet_cpsw        = scripting.addModule("/networking/enet_cpsw/enet_cpsw", {}, false);
const enet_cpsw1       = enet_cpsw.addInstance();
const dm_power_config  = scripting.addModule("/pdm_utils/tools/dm_power_config_tool/dm_power_config", {}, false);
const dm_power_config1 = dm_power_config.addInstance();

/**
 * Write custom configuration values to the imported modules.
 */
dss1.$name                  = "CONFIG_DSS0";
dss1.selectOverlayManager   = "OVR2";
dss1.selectVP               = "VP2";
dss1.selectDisplayInterface = "HDMI";

dss2.$name                  = "CONFIG_DSS1";
dss2.selectOverlayManager   = "OVR4";
dss2.selectVP               = "VP4";
dss2.selectDisplayInterface = "DSI";

i2c1.useWakeupDomainPeripherals = false;
i2c1.bitRate                    = "100KHZ";
i2c1.$name                      = "HDMI_AND_DSI_BRIDGE_I2C_CONFIG";
i2c1.I2C_child.$name            = "drivers_i2c_v0_i2c_v0_template0";
i2c1.I2C.$assign                = "I2C1";

i2c2.$name                      = "CONFIG_I2C2";
i2c2.useWakeupDomainPeripherals = false;
i2c2.I2C_child.$name            = "drivers_i2c_v0_i2c_v0_template1";
i2c2.I2C.$assign                = "I2C2";

udma1.$name = "CONFIG_UDMA0";

addr_translate1.$name      = "CONFIG_ADDR_TRANSLATE_REGION0";
addr_translate1.localAddr  = 0xC0000000;
addr_translate1.systemAddr = 0x900000000;

debug_log.enableLogZoneWarning = false;
debug_log.enableLogZoneError   = false;

mpu_armv71.size         = 31;
mpu_armv71.attributes   = "Device";
mpu_armv71.allowExecute = false;
mpu_armv71.$name        = "CONFIG_MPU_REGISTER";

mpu_armv72.size       = 15;
mpu_armv72.$name      = "CONFIG_MPU_TCMA";
mpu_armv72.attributes = "NonCached";

mpu_armv73.baseAddr   = 0x41010000;
mpu_armv73.size       = 15;
mpu_armv73.$name      = "CONFIG_MPU_TCMB";
mpu_armv73.attributes = "NonCached";

mpu_armv74.baseAddr = 0x60000000;
mpu_armv74.size     = 26;
mpu_armv74.$name    = "CONFIG_MPU_FLASH";

mpu_armv75.baseAddr = 0x79100000;
mpu_armv75.size     = 19;
mpu_armv75.$name    = "CONFIG_MPU_MCU_MSRAM";

mpu_armv76.baseAddr = 0x80000000;
mpu_armv76.size     = 31;
mpu_armv76.$name    = "CONFIG_MPU_DDR";

mpu_armv77.baseAddr     = 0xA2000000;
mpu_armv77.size         = 20;
mpu_armv77.$name        = "LINUX_VRING";
mpu_armv77.allowExecute = false;
mpu_armv77.attributes   = "NonCached";

mpu_armv78.baseAddr     = 0xA2100000;
mpu_armv78.size         = 20;
mpu_armv78.allowExecute = false;
mpu_armv78.$name        = "RESOURCE_TABLE_AND_TRACE";
mpu_armv78.attributes   = "NonCached";

mpu_armv79.baseAddr     = 0xA5000000;
mpu_armv79.size         = 24;
mpu_armv79.allowExecute = false;
mpu_armv79.$name        = "IPC_VRING_MEM_MPU";
mpu_armv79.attributes   = "NonCached";

mpu_armv710.baseAddr     = 0xA6000000;
mpu_armv710.size         = 24;
mpu_armv710.allowExecute = false;
mpu_armv710.$name        = "TIOVX_LOG_RT_MEM_MPU";
mpu_armv710.attributes   = "NonCached";

mpu_armv711.baseAddr     = 0xA7000000;
mpu_armv711.size         = 23;
mpu_armv711.allowExecute = false;
mpu_armv711.$name        = "TIOVX_OBJ_DESC_MEM_MPU";
mpu_armv711.attributes   = "NonCached";

mpu_armv712.baseAddr     = 0xA7800000;
mpu_armv712.size         = 22;
mpu_armv712.allowExecute = false;
mpu_armv712.$name        = "APP_FILEIO_MEM_MPU";
mpu_armv712.attributes   = "NonCached";

mpu_armv713.baseAddr     = 0xA7C00000;
mpu_armv713.size         = 18;
mpu_armv713.allowExecute = false;
mpu_armv713.$name        = "APP_LOG_MEM_MPU";
mpu_armv713.attributes   = "NonCached";

mpu_armv714.baseAddr     = 0xB7800000;
mpu_armv714.size         = 22;
mpu_armv714.allowExecute = false;
mpu_armv714.$name        = "DDR_MCU2_0_VISS_CONFIG_HEAP_MPU";
mpu_armv714.attributes   = "CUSTOM";
mpu_armv714.tex          = 7;
mpu_armv714.isBufferable = false;

mpu_armv715.baseAddr     = 0xB8000000;
mpu_armv715.size         = 24;
mpu_armv715.allowExecute = false;
mpu_armv715.$name        = "INTERCORE_REGION";
mpu_armv715.attributes   = "NonCached";

default_linker1.$name = "memory_configurator_default_linker0";

region1.$name                                = "MEMORY_REGION_CONFIGURATION0";
region1.memory_region.create(22);
region1.memory_region[0].$name               = "R5F_TCMA_VECS";
region1.memory_region[0].size                = 0x40;
region1.memory_region[0].auto                = false;
region1.memory_region[0].attributes          = ["X"];
region1.memory_region[1].$name               = "R5F_TCMA";
region1.memory_region[1].size                = 0x7FC0;
region1.memory_region[1].auto                = false;
region1.memory_region[1].manualStartAddress  = 0x40;
region1.memory_region[1].attributes          = ["X"];
region1.memory_region[2].type                = "TCMB_R5F";
region1.memory_region[2].$name               = "R5F_TCMB";
region1.memory_region[2].size                = 0x8000;
region1.memory_region[2].auto                = false;
region1.memory_region[3].type                = "DDR_LOW_ALL";
region1.memory_region[3].$name               = "DDR_MCU2_0_IPC";
region1.memory_region[3].size                = 0x100000;
region1.memory_region[3].auto                = false;
region1.memory_region[3].manualStartAddress  = 0xA2000000;
region1.memory_region[4].type                = "DDR_LOW_ALL";
region1.memory_region[4].$name               = "DDR_MCU2_0_RESOURCE_TABLE";
region1.memory_region[4].size                = 0x400;
region1.memory_region[4].auto                = false;
region1.memory_region[4].manualStartAddress  = 0xA2100000;
region1.memory_region[5].type                = "DDR_LOW_ALL";
region1.memory_region[5].$name               = "DDR_MCU2_0_IPC_TRACE";
region1.memory_region[5].size                = 0xFFC00;
region1.memory_region[5].auto                = false;
region1.memory_region[5].manualStartAddress  = 0xA2100400;
region1.memory_region[6].type                = "DDR_LOW_ALL";
region1.memory_region[6].$name               = "DDR_MCU2_0";
region1.memory_region[6].size                = 0x1E00000;
region1.memory_region[6].auto                = false;
region1.memory_region[6].manualStartAddress  = 0xA2200000;
region1.memory_region[7].type                = "DDR_LOW_ALL";
region1.memory_region[7].$name               = "IPC_VRING_MEM";
region1.memory_region[7].size                = 0x1000000;
region1.memory_region[7].auto                = false;
region1.memory_region[7].manualStartAddress  = 0xA5000000;
region1.memory_region[7].attributes          = ["R","W"];
region1.memory_region[7].isShared            = true;
region1.memory_region[7].shared_cores        = ["c75ss0-0","c75ss1-0","wkup-r5fss0-0"];
region1.memory_region[8].type                = "DDR_LOW_ALL";
region1.memory_region[8].$name               = "TIOVX_OBJ_DESC_MEM_HOST0";
region1.memory_region[8].size                = 0x2AA000;
region1.memory_region[8].auto                = false;
region1.memory_region[8].manualStartAddress  = 0xA7000000;
region1.memory_region[8].attributes          = ["R","W"];
region1.memory_region[8].isShared            = true;
region1.memory_region[8].shared_cores        = ["c75ss0-0","c75ss1-0","wkup-r5fss0-0"];
region1.memory_region[9].type                = "DDR_LOW_ALL";
region1.memory_region[9].$name               = "TIOVX_OBJ_DESC_MEM_HOST1";
region1.memory_region[9].size                = 0x2AA000;
region1.memory_region[9].auto                = false;
region1.memory_region[9].manualStartAddress  = 0xA72AA000;
region1.memory_region[9].attributes          = ["R","W"];
region1.memory_region[9].isShared            = true;
region1.memory_region[9].shared_cores        = ["c75ss0-0","c75ss1-0","wkup-r5fss0-0"];
region1.memory_region[10].type               = "DDR_LOW_ALL";
region1.memory_region[10].$name              = "TIOVX_OBJ_DESC_MEM_HOST2";
region1.memory_region[10].size               = 0x2AA000;
region1.memory_region[10].auto               = false;
region1.memory_region[10].manualStartAddress = 0xA7554000;
region1.memory_region[10].attributes         = ["R","W"];
region1.memory_region[10].isShared           = true;
region1.memory_region[10].shared_cores       = ["c75ss0-0","c75ss1-0","wkup-r5fss0-0"];
region1.memory_region[11].type               = "DDR_LOW_ALL";
region1.memory_region[11].$name              = "APP_FILEIO_MEM";
region1.memory_region[11].size               = 0x400000;
region1.memory_region[11].auto               = false;
region1.memory_region[11].manualStartAddress = 0xA7800000;
region1.memory_region[11].attributes         = ["R","W"];
region1.memory_region[11].isShared           = true;
region1.memory_region[11].shared_cores       = ["c75ss0-0","c75ss1-0","wkup-r5fss0-0"];
region1.memory_region[12].type               = "DDR_LOW_ALL";
region1.memory_region[12].$name              = "APP_LOG_MEM";
region1.memory_region[12].size               = 0x40000;
region1.memory_region[12].auto               = false;
region1.memory_region[12].manualStartAddress = 0xA7C00000;
region1.memory_region[12].attributes         = ["R","W"];
region1.memory_region[12].isShared           = true;
region1.memory_region[12].shared_cores       = ["c75ss0-0","c75ss1-0","wkup-r5fss0-0"];
region1.memory_region[13].type               = "DDR_LOW_ALL";
region1.memory_region[13].$name              = "DDR_MCU2_0_LOCAL_HEAP";
region1.memory_region[13].size               = 0x2000000;
region1.memory_region[13].auto               = false;
region1.memory_region[13].manualStartAddress = 0xB5800000;
region1.memory_region[14].type               = "DDR_LOW_ALL";
region1.memory_region[14].$name              = "DDR_MCU2_0_VISS_CONFIG_HEAP";
region1.memory_region[14].size               = 0x400000;
region1.memory_region[14].auto               = false;
region1.memory_region[14].manualStartAddress = 0xB7800000;
region1.memory_region[15].type               = "DDR_LOW_ALL";
region1.memory_region[15].$name              = "INTERCORE_ETH_DESC_MEM";
region1.memory_region[15].size               = 0x200000;
region1.memory_region[15].auto               = false;
region1.memory_region[15].manualStartAddress = 0xB8000000;
region1.memory_region[15].attributes         = ["R","W"];
region1.memory_region[16].type               = "DDR_LOW_ALL";
region1.memory_region[16].$name              = "INTERCORE_ETH_DATA_MEM";
region1.memory_region[16].size               = 0xE00000;
region1.memory_region[16].auto               = false;
region1.memory_region[16].manualStartAddress = 0xB8200000;
region1.memory_region[16].attributes         = ["R","W"];
region1.memory_region[17].type               = "DDR_LOW_ALL";
region1.memory_region[17].$name              = "DDR_SHARED_MEM";
region1.memory_region[17].size               = 0x20000000;
region1.memory_region[17].auto               = false;
region1.memory_region[17].manualStartAddress = 0xC0000000;
region1.memory_region[17].attributes         = ["R"];
region1.memory_region[17].isShared           = true;
region1.memory_region[17].shared_cores       = ["c75ss0-0","c75ss1-0","wkup-r5fss0-0"];
region1.memory_region[17].allowOverlap       = true;
region1.memory_region[18].type               = "DDR_LOW_ALL";
region1.memory_region[18].$name              = "DDR_SHARED_MEM_HOST0";
region1.memory_region[18].size               = 0xAAAA000;
region1.memory_region[18].auto               = false;
region1.memory_region[18].manualStartAddress = 0xC0000000;
region1.memory_region[18].attributes         = ["R"];
region1.memory_region[18].isShared           = true;
region1.memory_region[18].shared_cores       = ["c75ss0-0","c75ss1-0","wkup-r5fss0-0"];
region1.memory_region[19].type               = "DDR_LOW_ALL";
region1.memory_region[19].$name              = "DDR_SHARED_MEM_HOST1";
region1.memory_region[19].size               = 0xAAAA000;
region1.memory_region[19].auto               = false;
region1.memory_region[19].manualStartAddress = 0xCAAAA000;
region1.memory_region[19].attributes         = ["R"];
region1.memory_region[19].isShared           = true;
region1.memory_region[19].shared_cores       = ["c75ss0-0","c75ss1-0","wkup-r5fss0-0"];
region1.memory_region[20].type               = "DDR_LOW_ALL";
region1.memory_region[20].$name              = "DDR_SHARED_MEM_HOST2";
region1.memory_region[20].size               = 0xAAAA000;
region1.memory_region[20].auto               = false;
region1.memory_region[20].manualStartAddress = 0xD5554000;
region1.memory_region[20].attributes         = ["R"];
region1.memory_region[20].isShared           = true;
region1.memory_region[20].shared_cores       = ["c75ss0-0","c75ss1-0","wkup-r5fss0-0"];
region1.memory_region[21].type               = "DDR_LOW_ALL";
region1.memory_region[21].auto               = false;
region1.memory_region[21].manualStartAddress = 0xA6000000;
region1.memory_region[21].size               = 0x1000000;
region1.memory_region[21].isShared           = true;
region1.memory_region[21].shared_cores       = ["c75ss0-0","c75ss1-0","wkup-r5fss0-0"];
region1.memory_region[21].$name              = "TIOVX_LOG_RT_MEM";

enet_cpsw1.$name                               = "CONFIG_ENET_CPSW0";
enet_cpsw1.IsEthFw                             = true;
enet_cpsw1.macAddrConfig                       = "Manual Entry";
enet_cpsw1.LargePoolPktCount                   = 64;
enet_cpsw1.PktInfoOnlyEnable                   = true;
enet_cpsw1.macAddrList                         = "70:ff:76:1d:ec:f2,70:ff:76:1d:ec:e3,70:ff:76:1d:ec:e4";
enet_cpsw1.cpswVlanAwareMode                   = true;
enet_cpsw1.vlanId_hostPort                     = 0x1;
enet_cpsw1.vlanId_macPort1                     = 0x3;
enet_cpsw1.vlanId_macPort2                     = 0x3;
enet_cpsw1.hostportRxMtu                       = 1522;
enet_cpsw1.DisableMacPort2                     = true;
enet_cpsw1.RGMII1.$assign                      = "RGMII1";
enet_cpsw1.txDmaChannel.create(2);
enet_cpsw1.txDmaChannel[0].$name               = "ENET_DMA_TX_CH0";
enet_cpsw1.txDmaChannel[1].$name               = "ENET_DMA_TX_CH_PTP";
enet_cpsw1.rxDmaChannel.create(3);
enet_cpsw1.rxDmaChannel[0].$name               = "ENET_DMA_RX_CH0";
enet_cpsw1.rxDmaChannel[0].PacketsCount        = 16;
enet_cpsw1.rxDmaChannel[0].useGlobalEvt        = true;
enet_cpsw1.rxDmaChannel[1].$name               = "ENET_DMA_RX_CH1";
enet_cpsw1.rxDmaChannel[1].macAddrCount        = 0;
enet_cpsw1.rxDmaChannel[1].useDefaultFlow      = false;
enet_cpsw1.rxDmaChannel[1].PacketsCount        = 16;
enet_cpsw1.rxDmaChannel[1].useGlobalEvt        = true;
enet_cpsw1.rxDmaChannel[2].$name               = "ENET_DMA_RX_CH_PTP";
enet_cpsw1.rxDmaChannel[2].useDefaultFlow      = false;
enet_cpsw1.rxDmaChannel[2].PacketsCount        = 16;
enet_cpsw1.rxDmaChannel[2].useGlobalEvt        = true;
enet_cpsw1.rxDmaChannel[2].macAddrCount        = 0;
enet_cpsw1.netifInstance.create(1);
enet_cpsw1.netifInstance[0].$name              = "NETIF_INST_ID0";
enet_cpsw1.netifInstance[0].enableProxyArp     = true;
enet_cpsw1.netifInstance[0].proxyArpRxDmaChNum = ["1"];

const ethphy_cpsw_icssg  = scripting.addModule("/board/ethphy_cpsw_icssg/ethphy_cpsw_icssg", {}, false);
const ethphy_cpsw_icssg1 = ethphy_cpsw_icssg.addInstance({}, false);
ethphy_cpsw_icssg1.$name = "CONFIG_ENET_ETHPHY0";
enet_cpsw1.ethphy1       = ethphy_cpsw_icssg1;

const udma2        = udma.addInstance({}, false);
enet_cpsw1.udmaDrv = udma2;

dm_power_config1.$name                           = "PowerConfig0";
dm_power_config1.MAIN_R5FSS_1                    = 0;
dm_power_config1.MCU_R5FSS_0                     = 0;
dm_power_config1.MAIN_C71SS_0                    = 0;
dm_power_config1.MAIN_C71SS_1                    = 0;
dm_power_config1.MAIN_GPU_0                      = 0;
dm_power_config1["MAIN_Video_Encoder/Decoder_0"] = 0;
dm_power_config1.CSI_TX_ESC_CLK                  = 0;
dm_power_config1.CSI_TX_MAIN_CLK                 = 0;
dm_power_config1.MAIN_CSI_RX                     = ["TISCI_DEV_CSI_RX_IF0","TISCI_DEV_CSI_RX_IF1","TISCI_DEV_DPHY_RX0","TISCI_DEV_DPHY_RX1"];

/**
 * Pinmux solution for unlocked pins/peripherals. This ensures that minor changes to the automatic solver in a future
 * version of the tool will not impact the pinmux you originally saw.  These lines can be completely deleted in order to
 * re-solve from scratch.
 */
dss1.DSS.$suggestSolution                 = "DSS0";
dss1.DSS.DATA0.$suggestSolution           = "VOUT0_DATA0";
dss1.DSS.DATA1.$suggestSolution           = "VOUT0_DATA1";
dss1.DSS.DATA2.$suggestSolution           = "VOUT0_DATA2";
dss1.DSS.DATA3.$suggestSolution           = "VOUT0_DATA3";
dss1.DSS.DATA4.$suggestSolution           = "VOUT0_DATA4";
dss1.DSS.DATA5.$suggestSolution           = "VOUT0_DATA5";
dss1.DSS.DATA6.$suggestSolution           = "VOUT0_DATA6";
dss1.DSS.DATA7.$suggestSolution           = "VOUT0_DATA7";
dss1.DSS.DATA8.$suggestSolution           = "VOUT0_DATA8";
dss1.DSS.DATA9.$suggestSolution           = "VOUT0_DATA9";
dss1.DSS.DATA10.$suggestSolution          = "VOUT0_DATA10";
dss1.DSS.DATA11.$suggestSolution          = "VOUT0_DATA11";
dss1.DSS.DATA12.$suggestSolution          = "VOUT0_DATA12";
dss1.DSS.DATA13.$suggestSolution          = "VOUT0_DATA13";
dss1.DSS.DATA14.$suggestSolution          = "VOUT0_DATA14";
dss1.DSS.DATA15.$suggestSolution          = "VOUT0_DATA15";
dss1.DSS.DATA16.$suggestSolution          = "GPMC0_AD8";
dss1.DSS.DATA17.$suggestSolution          = "GPMC0_AD9";
dss1.DSS.DATA18.$suggestSolution          = "GPMC0_AD10";
dss1.DSS.DATA19.$suggestSolution          = "GPMC0_AD11";
dss1.DSS.DATA20.$suggestSolution          = "GPMC0_AD12";
dss1.DSS.DATA21.$suggestSolution          = "GPMC0_AD13";
dss1.DSS.DATA22.$suggestSolution          = "GPMC0_AD14";
dss1.DSS.DATA23.$suggestSolution          = "GPMC0_AD15";
dss1.DSS.DE.$suggestSolution              = "VOUT0_DE";
dss1.DSS.EXTPCLKIN.$suggestSolution       = "GPMC0_WAIT1";
dss1.DSS.HSYNC.$suggestSolution           = "VOUT0_HSYNC";
dss1.DSS.PCLK.$suggestSolution            = "VOUT0_PCLK";
dss1.DSS.VSYNC.$suggestSolution           = "VOUT0_VSYNC";
dss2.DSS.$suggestSolution                 = "DSS0";
i2c1.I2C.SCL.$suggestSolution             = "I2C1_SCL";
i2c1.I2C.SDA.$suggestSolution             = "I2C1_SDA";
i2c2.I2C.SCL.$suggestSolution             = "GPMC0_CSn2";
i2c2.I2C.SDA.$suggestSolution             = "GPMC0_CSn3";
enet_cpsw1.MDIO.$suggestSolution          = "MDIO0";
enet_cpsw1.MDIO.MDC.$suggestSolution      = "MDIO0_MDC";
enet_cpsw1.MDIO.MDIO.$suggestSolution     = "MDIO0_MDIO";
enet_cpsw1.RGMII1.RD0.$suggestSolution    = "RGMII1_RD0";
enet_cpsw1.RGMII1.RD1.$suggestSolution    = "RGMII1_RD1";
enet_cpsw1.RGMII1.RD2.$suggestSolution    = "RGMII1_RD2";
enet_cpsw1.RGMII1.RD3.$suggestSolution    = "RGMII1_RD3";
enet_cpsw1.RGMII1.RX_CTL.$suggestSolution = "RGMII1_RX_CTL";
enet_cpsw1.RGMII1.RXC.$suggestSolution    = "RGMII1_RXC";
enet_cpsw1.RGMII1.TD0.$suggestSolution    = "RGMII1_TD0";
enet_cpsw1.RGMII1.TD1.$suggestSolution    = "RGMII1_TD1";
enet_cpsw1.RGMII1.TD2.$suggestSolution    = "RGMII1_TD2";
enet_cpsw1.RGMII1.TD3.$suggestSolution    = "RGMII1_TD3";
enet_cpsw1.RGMII1.TX_CTL.$suggestSolution = "RGMII1_TX_CTL";
enet_cpsw1.RGMII1.TXC.$suggestSolution    = "RGMII1_TXC";
