/**
 * @cliArgs --device "J722S_TDA4VEN_TDA4AEN_AM67" --package "AMW" --part "Default" --context "main-r5fss0-0" --product "MCU_PLUS_SDK@07.03.01"
 * @versions {"tool":"1.20.0+3562"}
 */

/**
 * Import the modules used in this configuration.
 */
const debug_log  = scripting.addModule("/kernel/dpl/debug_log");
const mpu_armv7  = scripting.addModule("/kernel/dpl/mpu_armv7", {}, false);
const mpu_armv71 = mpu_armv7.addInstance();
const mpu_armv72 = mpu_armv7.addInstance();
const mpu_armv73 = mpu_armv7.addInstance();
const mpu_armv74 = mpu_armv7.addInstance();
const mpu_armv75 = mpu_armv7.addInstance();
const mpu_armv76 = mpu_armv7.addInstance();
const mpu_armv77 = mpu_armv7.addInstance();
const mpu_armv78 = mpu_armv7.addInstance();
const mpu_armv79 = mpu_armv7.addInstance();

const addr_translate  = scripting.addModule("/kernel/dpl/addr_translate", {}, false);
const addr_translate1 = addr_translate.addInstance();

/**
 * Write custom configuration values to the imported modules.
 */
debug_log.enableSharedMemLog   = false;
debug_log.enableLogZoneWarning = false;
debug_log.enableLogZoneError   = false;
debug_log.enableUartLog        = false;


mpu_armv71.baseAddr            = 0x0;
mpu_armv71.size                = 31; /* 2 GB */
mpu_armv71.attributes          = "Device";
mpu_armv71.allowExecute        = false;
mpu_armv71.$name               = "CONFIG_MPU_REGISTER";

mpu_armv72.baseAddr            = 0x0;
mpu_armv72.size                = 15; /* 32 KB */
mpu_armv72.$name               = "CONFIG_MPU_TCMA";
mpu_armv72.allowExecute        = true;
mpu_armv72.attributes          = "NonCached";

mpu_armv73.baseAddr            = 0x41010000;
mpu_armv73.size                = 15; /* 32 KB */
mpu_armv73.$name               = "CONFIG_MPU_TCMB";
mpu_armv73.allowExecute        = true;
mpu_armv73.attributes          = "NonCached";

mpu_armv74.baseAddr            = 0x60000000;
mpu_armv74.size                = 26; /* 64 MB */
mpu_armv74.$name               = "CONFIG_MPU_FLASH";
mpu_armv74.allowExecute        = true;

mpu_armv75.baseAddr            = 0x79100000;
mpu_armv75.size                = 19; /* 512 KB */
mpu_armv75.$name               = "CONFIG_MPU_MCU_MSRAM";
mpu_armv75.allowExecute        = true;

mpu_armv76.baseAddr            = 0x80000000;
mpu_armv76.size                = 31; /* 2 GB */
mpu_armv76.$name               = "CONFIG_MPU_DDR";
mpu_armv76.allowExecute        = true;

/* Memory Section: LINUX_VRING + RESOURCE_TABLE_AND_TRACE */
mpu_armv77.baseAddr            = 0xA2000000;
mpu_armv77.size                = 21;
mpu_armv77.$name               = "LINUX_VRING_AND_RESOURCE_TABLE";
mpu_armv77.allowExecute        = false;
mpu_armv77.attributes          = "NonCached";

/* Memory Section: IPC_VRING_MEM + TIOVX_LOG_RT_MEM + TIOVX_OBJ_DESC_MEM + APP_FILEIO_MEM + TIOVX_LOG_RT_MEM
 * Note: SafeRTOS only allows 10 MPU regions (from 1 to 10). To adhere to this limitation, we consolidated multiple regions into one.
 * This consolidation ensures alignment of the size with the address. The base address 0xA4000000 was chosen over 0xA500000
 * to maintain proper alignment and accommodate other regions efficiently. */
mpu_armv78.baseAddr            = 0xA4000000;
mpu_armv78.size                = 26;
mpu_armv78.allowExecute        = false;
mpu_armv78.$name               = "DDR_SHARED_MEM_NON_CACHE";
mpu_armv78.attributes          = "NonCached";

mpu_armv79.baseAddr           = 0xB7800000;
mpu_armv79.size               = 22;
mpu_armv79.allowExecute       = false;
mpu_armv79.$name              = "DDR_MCU2_0_VISS_CONFIG_HEAP";
mpu_armv79.attributes         = "CUSTOM";
mpu_armv79.tex                = 7;
mpu_armv79.isBufferable       = false;
mpu_armv79.isCacheable        = true;

addr_translate1.$name      = "CONFIG_ADDR_TRANSLATE_REGION0";
addr_translate1.localAddr  = 0xC0000000;
addr_translate1.systemAddr = 0x900000000;
