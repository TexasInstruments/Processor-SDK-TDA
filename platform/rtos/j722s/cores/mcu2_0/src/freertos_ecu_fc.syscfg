/**
 * @cliArgs --device "J722S_TDA4VEN_TDA4AEN_AM67" --package "AMW" --part "Default" --context "main-r5fss0-0" --product "MCU_PLUS_SDK@07.03.01"
 * @versions {"tool":"1.20.0+3587"}
 */

/**
 * Import the modules used in this configuration.
 */
const dss             = scripting.addModule("/drivers/dss/dss", {}, false);
const dss1            = dss.addInstance();
const i2c             = scripting.addModule("/drivers/i2c/i2c", {}, false);
const i2c1            = i2c.addInstance();
const i2c2            = i2c.addInstance();
const addr_translate  = scripting.addModule("/kernel/dpl/addr_translate", {}, false);
const addr_translate1 = addr_translate.addInstance();
const debug_log       = scripting.addModule("/kernel/dpl/debug_log");
const mpu_armv7       = scripting.addModule("/kernel/dpl/mpu_armv7", {}, false);
const mpu_armv71      = mpu_armv7.addInstance();
const mpu_armv72      = mpu_armv7.addInstance();
const mpu_armv73      = mpu_armv7.addInstance();
const mpu_armv74      = mpu_armv7.addInstance();
const mpu_armv75      = mpu_armv7.addInstance();
const mpu_armv76      = mpu_armv7.addInstance();
const mpu_armv77      = mpu_armv7.addInstance();
const mpu_armv78      = mpu_armv7.addInstance();
const mpu_armv79      = mpu_armv7.addInstance();
const mpu_armv710     = mpu_armv7.addInstance();
const mpu_armv711     = mpu_armv7.addInstance();
const mpu_armv712     = mpu_armv7.addInstance();
const mpu_armv713     = mpu_armv7.addInstance();
const mpu_armv714     = mpu_armv7.addInstance();
const mpu_armv715     = mpu_armv7.addInstance();
const enet_cpsw       = scripting.addModule("/networking/enet_cpsw/enet_cpsw", {}, false);
const enet_cpsw1      = enet_cpsw.addInstance();

/**
 * Write custom configuration values to the imported modules.
 */
dss1.$name                  = "CONFIG_DSS0";
dss1.selectOverlayManager   = "OVR2";
dss1.selectVP               = "VP2";
dss1.selectDisplayInterface = "HDMI";

i2c1.useWakeupDomainPeripherals = false;
i2c1.bitRate                    = "100KHZ";
i2c1.$name                      = "HDMI_AND_DSI_BRIDGE_I2C_CONFIG";
i2c1.I2C.$assign                = "I2C1";

i2c2.$name                      = "CONFIG_I2C2";
i2c2.useWakeupDomainPeripherals = false;
i2c2.I2C.$assign                = "I2C2";

addr_translate1.$name      = "CONFIG_ADDR_TRANSLATE_REGION0";
addr_translate1.localAddr  = 0xC0000000;
addr_translate1.systemAddr = 0x900000000;

debug_log.enableLogZoneWarning = false;
debug_log.enableLogZoneError   = false;

mpu_armv71.size         = 31;
mpu_armv71.attributes   = "Device";
mpu_armv71.allowExecute = false;
mpu_armv71.$name        = "CONFIG_MPU_REGISTER";

mpu_armv72.size       = 15;
mpu_armv72.$name      = "CONFIG_MPU_TCMA";
mpu_armv72.attributes = "NonCached";

mpu_armv73.baseAddr   = 0x41010000;
mpu_armv73.size       = 15;
mpu_armv73.$name      = "CONFIG_MPU_TCMB";
mpu_armv73.attributes = "NonCached";

mpu_armv74.baseAddr = 0x60000000;
mpu_armv74.size     = 26;
mpu_armv74.$name    = "CONFIG_MPU_FLASH";

mpu_armv75.baseAddr = 0x79100000;
mpu_armv75.size     = 19;
mpu_armv75.$name    = "CONFIG_MPU_MCU_MSRAM";

mpu_armv76.baseAddr = 0x80000000;
mpu_armv76.size     = 31;
mpu_armv76.$name    = "CONFIG_MPU_DDR";

mpu_armv77.baseAddr     = 0xA2000000;
mpu_armv77.size         = 20;
mpu_armv77.$name        = "LINUX_VRING";
mpu_armv77.allowExecute = false;
mpu_armv77.attributes   = "NonCached";

mpu_armv78.baseAddr     = 0xA2100000;
mpu_armv78.size         = 20;
mpu_armv78.allowExecute = false;
mpu_armv78.$name        = "RESOURCE_TABLE_AND_TRACE";
mpu_armv78.attributes   = "NonCached";

mpu_armv79.baseAddr     = 0xA5000000;
mpu_armv79.size         = 24;
mpu_armv79.allowExecute = false;
mpu_armv79.$name        = "IPC_VRING_MEM";
mpu_armv79.attributes   = "NonCached";

mpu_armv710.baseAddr     = 0xA6000000;
mpu_armv710.size         = 24;
mpu_armv710.allowExecute = false;
mpu_armv710.$name        = "TIOVX_LOG_RT_MEM";
mpu_armv710.attributes   = "NonCached";

mpu_armv711.baseAddr     = 0xA7000000;
mpu_armv711.size         = 23;
mpu_armv711.allowExecute = false;
mpu_armv711.$name        = "TIOVX_OBJ_DESC_MEM";
mpu_armv711.attributes   = "NonCached";

mpu_armv712.baseAddr     = 0xA7800000;
mpu_armv712.size         = 22;
mpu_armv712.allowExecute = false;
mpu_armv712.$name        = "APP_FILEIO_MEM";
mpu_armv712.attributes   = "NonCached";

mpu_armv713.baseAddr     = 0xA7C00000;
mpu_armv713.size         = 18;
mpu_armv713.allowExecute = false;
mpu_armv713.$name        = "APP_LOG_MEM";
mpu_armv713.attributes   = "NonCached";

mpu_armv714.baseAddr     = 0xB7800000;
mpu_armv714.size         = 22;
mpu_armv714.allowExecute = false;
mpu_armv714.$name        = "DDR_MCU2_0_VISS_CONFIG_HEAP";
mpu_armv714.attributes   = "CUSTOM";
mpu_armv714.tex          = 7;
mpu_armv714.isBufferable = false;
mpu_armv714.isCacheable  = true;

mpu_armv715.baseAddr   = 0xB8000000;
mpu_armv715.size       = 24;
mpu_armv715.allowExecute = false;
mpu_armv715.$name      = "INTERCORE_REGION";
mpu_armv715.attributes = "NonCached";

enet_cpsw1.$name                               = "CONFIG_ENET_CPSW0";
enet_cpsw1.IsEthFw                             = true;
enet_cpsw1.macAddrConfig                       = "Manual Entry";
enet_cpsw1.LargePoolPktCount                   = 64;
enet_cpsw1.PktInfoOnlyEnable                   = true;
enet_cpsw1.macAddrList                         = "70:ff:76:1d:ec:f2,70:ff:76:1d:ec:e3,70:ff:76:1d:ec:e4";
enet_cpsw1.cpswVlanAwareMode                   = true;
enet_cpsw1.vlanId_hostPort                     = 0x1;
enet_cpsw1.vlanId_macPort1                     = 0x3;
enet_cpsw1.vlanId_macPort2                     = 0x3;
enet_cpsw1.hostportRxMtu                       = 1522;
enet_cpsw1.RGMII1.$assign                      = "RGMII1";
enet_cpsw1.txDmaChannel.create(2);
enet_cpsw1.txDmaChannel[0].$name               = "ENET_DMA_TX_CH0";
enet_cpsw1.txDmaChannel[1].$name               = "ENET_DMA_TX_CH_PTP";
enet_cpsw1.rxDmaChannel.create(3);
enet_cpsw1.rxDmaChannel[0].$name               = "ENET_DMA_RX_CH0";
enet_cpsw1.rxDmaChannel[0].PacketsCount        = 16;
enet_cpsw1.rxDmaChannel[0].useGlobalEvt        = true;
enet_cpsw1.rxDmaChannel[1].$name               = "ENET_DMA_RX_CH1";
enet_cpsw1.rxDmaChannel[1].macAddrCount        = 0;
enet_cpsw1.rxDmaChannel[1].useDefaultFlow      = false;
enet_cpsw1.rxDmaChannel[1].PacketsCount        = 16;
enet_cpsw1.rxDmaChannel[1].useGlobalEvt        = true;
enet_cpsw1.rxDmaChannel[2].$name               = "ENET_DMA_RX_CH_PTP";
enet_cpsw1.rxDmaChannel[2].useDefaultFlow      = false;
enet_cpsw1.rxDmaChannel[2].PacketsCount        = 16;
enet_cpsw1.rxDmaChannel[2].useGlobalEvt        = true;
enet_cpsw1.rxDmaChannel[2].macAddrCount        = 0;
enet_cpsw1.netifInstance.create(1);
enet_cpsw1.netifInstance[0].$name              = "NETIF_INST_ID0";
enet_cpsw1.netifInstance[0].enableProxyArp     = true;
enet_cpsw1.netifInstance[0].proxyArpRxDmaChNum = ["1"];
enet_cpsw1.DisableMacPort2                     = true;

const ethphy_cpsw_icssg  = scripting.addModule("/board/ethphy_cpsw_icssg/ethphy_cpsw_icssg", {}, false);
const ethphy_cpsw_icssg1 = ethphy_cpsw_icssg.addInstance({}, false);
ethphy_cpsw_icssg1.$name     = "CONFIG_ENET_ETHPHY1";



const udma       = scripting.addModule("/drivers/udma/udma", {}, false);
const udma1      = udma.addInstance();

const udma2        = udma.addInstance({}, false);
enet_cpsw1.udmaDrv = udma2;

/**
 * Pinmux solution for unlocked pins/peripherals. This ensures that minor changes to the automatic solver in a future
 * version of the tool will not impact the pinmux you originally saw.  These lines can be completely deleted in order to
 * re-solve from scratch.
 */
enet_cpsw1.MDIO.$suggestSolution          = "MDIO0";
enet_cpsw1.MDIO.MDC.$suggestSolution      = "MDIO0_MDC";
enet_cpsw1.MDIO.MDIO.$suggestSolution     = "MDIO0_MDIO";
enet_cpsw1.RGMII1.RD0.$suggestSolution    = "RGMII1_RD0";
enet_cpsw1.RGMII1.RD1.$suggestSolution    = "RGMII1_RD1";
enet_cpsw1.RGMII1.RD2.$suggestSolution    = "RGMII1_RD2";
enet_cpsw1.RGMII1.RD3.$suggestSolution    = "RGMII1_RD3";
enet_cpsw1.RGMII1.RX_CTL.$suggestSolution = "RGMII1_RX_CTL";
enet_cpsw1.RGMII1.RXC.$suggestSolution    = "RGMII1_RXC";
enet_cpsw1.RGMII1.TD0.$suggestSolution    = "RGMII1_TD0";
enet_cpsw1.RGMII1.TD1.$suggestSolution    = "RGMII1_TD1";
enet_cpsw1.RGMII1.TD2.$suggestSolution    = "RGMII1_TD2";
enet_cpsw1.RGMII1.TD3.$suggestSolution    = "RGMII1_TD3";
enet_cpsw1.RGMII1.TX_CTL.$suggestSolution = "RGMII1_TX_CTL";
enet_cpsw1.RGMII1.TXC.$suggestSolution    = "RGMII1_TXC";

dss1.DSS.$suggestSolution           = "DSS0";
dss1.DSS.DATA0.$suggestSolution     = "VOUT0_DATA0";
dss1.DSS.DATA1.$suggestSolution     = "VOUT0_DATA1";
dss1.DSS.DATA2.$suggestSolution     = "VOUT0_DATA2";
dss1.DSS.DATA3.$suggestSolution     = "VOUT0_DATA3";
dss1.DSS.DATA4.$suggestSolution     = "VOUT0_DATA4";
dss1.DSS.DATA5.$suggestSolution     = "VOUT0_DATA5";
dss1.DSS.DATA6.$suggestSolution     = "VOUT0_DATA6";
dss1.DSS.DATA7.$suggestSolution     = "VOUT0_DATA7";
dss1.DSS.DATA8.$suggestSolution     = "VOUT0_DATA8";
dss1.DSS.DATA9.$suggestSolution     = "VOUT0_DATA9";
dss1.DSS.DATA10.$suggestSolution    = "VOUT0_DATA10";
dss1.DSS.DATA11.$suggestSolution    = "VOUT0_DATA11";
dss1.DSS.DATA12.$suggestSolution    = "VOUT0_DATA12";
dss1.DSS.DATA13.$suggestSolution    = "VOUT0_DATA13";
dss1.DSS.DATA14.$suggestSolution    = "VOUT0_DATA14";
dss1.DSS.DATA15.$suggestSolution    = "VOUT0_DATA15";
dss1.DSS.DATA16.$suggestSolution    = "GPMC0_AD8";
dss1.DSS.DATA17.$suggestSolution    = "GPMC0_AD9";
dss1.DSS.DATA18.$suggestSolution    = "GPMC0_AD10";
dss1.DSS.DATA19.$suggestSolution    = "GPMC0_AD11";
dss1.DSS.DATA20.$suggestSolution    = "GPMC0_AD12";
dss1.DSS.DATA21.$suggestSolution    = "GPMC0_AD13";
dss1.DSS.DATA22.$suggestSolution    = "GPMC0_AD14";
dss1.DSS.DATA23.$suggestSolution    = "GPMC0_AD15";
dss1.DSS.DE.$suggestSolution        = "VOUT0_DE";
dss1.DSS.EXTPCLKIN.$suggestSolution = "GPMC0_WAIT1";
dss1.DSS.HSYNC.$suggestSolution     = "VOUT0_HSYNC";
dss1.DSS.PCLK.$suggestSolution      = "VOUT0_PCLK";
dss1.DSS.VSYNC.$suggestSolution     = "VOUT0_VSYNC";
i2c1.I2C.SCL.$suggestSolution       = "I2C1_SCL";
i2c1.I2C.SDA.$suggestSolution       = "I2C1_SDA";
i2c2.I2C.SCL.$suggestSolution       = "GPMC0_CSn2";
i2c2.I2C.SDA.$suggestSolution       = "GPMC0_CSn3";
