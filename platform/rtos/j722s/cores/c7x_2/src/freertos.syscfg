/**
 * @cliArgs --device "J722S_TDA4VEN_TDA4AEN_AM67" --part "Default" --package "AMW" --context "c75ss1-0" --product "MCU_PLUS_SDK@07.03.01"
 * @versions {"tool":"1.26.2+4477"}
 */

/**
 * Import the modules used in this configuration.
 */
const debug_log       = scripting.addModule("/kernel/dpl/debug_log");
const mmu_armv8       = scripting.addModule("/kernel/dpl/mmu_armv8", {}, false);
const mmu_armv81      = mmu_armv8.addInstance();
const mmu_armv82      = mmu_armv8.addInstance();
const mmu_armv83      = mmu_armv8.addInstance();
const mmu_armv84      = mmu_armv8.addInstance();
const mmu_armv85      = mmu_armv8.addInstance();
const mmu_armv86      = mmu_armv8.addInstance();
const mmu_armv87      = mmu_armv8.addInstance();
const mmu_armv88      = mmu_armv8.addInstance();
const mmu_armv89      = mmu_armv8.addInstance();
const mmu_armv810     = mmu_armv8.addInstance();
const mmu_armv811     = mmu_armv8.addInstance();
const mmu_armv812     = mmu_armv8.addInstance();
const mmu_armv813     = mmu_armv8.addInstance();
const mmu_armv814     = mmu_armv8.addInstance();
const mmu_armv815     = mmu_armv8.addInstance();
const mmu_armv816     = mmu_armv8.addInstance();
const default_linker  = scripting.addModule("/memory_configurator/default_linker", {}, false);
const default_linker1 = default_linker.addInstance();
const region          = scripting.addModule("/memory_configurator/region", {}, false);
const region1         = region.addInstance();

/**
 * Write custom configuration values to the imported modules.
 */
debug_log.enableLogZoneWarning = false;
debug_log.enableLogZoneError   = false;

mmu_armv81.$name = "REGISTER_REGION_0";
mmu_armv81.size  = 0x20000000;

mmu_armv82.$name = "REGISTER_REGION_1";
mmu_armv82.vAddr = 0x20000000;
mmu_armv82.pAddr = 0x20000000;
mmu_armv82.size  = 0x20000000;

mmu_armv83.$name = "REGISTER_REGION_2";
mmu_armv83.vAddr = 0x40000000;
mmu_armv83.pAddr = 0x40000000;
mmu_armv83.size  = 0x20000000;

mmu_armv84.$name = "FSS0_DAT_REGION";
mmu_armv84.vAddr = 0x60000000;
mmu_armv84.pAddr = 0x60000000;
mmu_armv84.size  = 0x4000000;

mmu_armv85.$name = "CLEC";
mmu_armv85.vAddr = 0x7D200000;
mmu_armv85.pAddr = 0x7D200000;
mmu_armv85.size  = 0x100000;

mmu_armv86.$name = "DRU";
mmu_armv86.vAddr = 0x7D400000;
mmu_armv86.pAddr = 0x7D400000;
mmu_armv86.size  = 0x100000;

mmu_armv87.$name     = "L2RAM_C7x_2_MAIN_MMU";
mmu_armv87.vAddr     = 0x7E200000;
mmu_armv87.pAddr     = 0x7E200000;
mmu_armv87.size      = 0x200000;
mmu_armv87.attribute = "MAIR7";

mmu_armv88.$name     = "L2RAM_C7x_2_AUX_MMU";
mmu_armv88.vAddr     = 0x7F800000;
mmu_armv88.pAddr     = 0x7F800000;
mmu_armv88.size      = 0x40000;
mmu_armv88.attribute = "MAIR7";

mmu_armv89.$name     = "DDR_C7x_2_DTS";
mmu_armv89.vAddr     = 0xB1100000;
mmu_armv89.pAddr     = 0xB1100000;
mmu_armv89.size      = 0x3F00000;
mmu_armv89.attribute = "MAIR7";

mmu_armv810.$name     = "DDR_SHARED_MEM_MMU";
mmu_armv810.vAddr     = 0xC0000000;
mmu_armv810.pAddr     = 0x900000000;
mmu_armv810.size      = 0x20000000;
mmu_armv810.attribute = "MAIR7";

mmu_armv811.$name     = "DDR_SHARED_MEM_NON_CACHE";
mmu_armv811.vAddr     = 0xA5000000;
mmu_armv811.pAddr     = 0xA5000000;
mmu_armv811.size      = 0x2C40000;
mmu_armv811.attribute = "MAIR4";

mmu_armv812.$name     = "DDR_C7x_2_IPC_MMU";
mmu_armv812.vAddr     = 0xB1000000;
mmu_armv812.pAddr     = 0xB1000000;
mmu_armv812.size      = 0x100000;
mmu_armv812.attribute = "MAIR4";

mmu_armv813.$name     = "DDR_C7X_1_HEAP_SCRATCH_NON_CACHEABLE";
mmu_armv813.pAddr     = 0x880000000;
mmu_armv813.size      = 0x8000000;
mmu_armv813.attribute = "MAIR4";
mmu_armv813.vAddr     = 0x100000000;

mmu_armv814.$name     = "DDR_C7X_1_HEAP_SCRATCH_CACHEABLE";
mmu_armv814.pAddr     = 0x888000000;
mmu_armv814.size      = 0x8000000;
mmu_armv814.attribute = "MAIR7";
mmu_armv814.vAddr     = 0x108000000;

mmu_armv815.$name     = "DDR_C7X_2_HEAP_SCRATCH_NON_CACHEABLE";
mmu_armv815.pAddr     = 0x890000000;
mmu_armv815.size      = 0x8000000;
mmu_armv815.attribute = "MAIR4";
mmu_armv815.vAddr     = 0x110000000;

mmu_armv816.$name     = "DDR_C7X_2_HEAP_SCRATCH_CACHEABLE";
mmu_armv816.pAddr     = 0x898000000;
mmu_armv816.size      = 0x8000000;
mmu_armv816.attribute = "MAIR7";
mmu_armv816.vAddr     = 0x118000000;

default_linker1.$name = "memory_configurator_default_linker0";

region1.$name                                = "MEMORY_REGION_CONFIGURATION0";
region1.memory_region.create(18);
region1.memory_region[0].type                = "L3_C75";
region1.memory_region[0].$name               = "L2RAM_C7x_2_MAIN";
region1.memory_region[0].size                = 0x200000;
region1.memory_region[0].auto                = false;
region1.memory_region[0].manualStartAddress  = 0x7E200000;
region1.memory_region[1].type                = "L2_C75SS1-0";
region1.memory_region[1].$name               = "L2RAM_C7x_2_AUX";
region1.memory_region[1].size                = 0x3C000;
region1.memory_region[1].auto                = false;
region1.memory_region[2].type                = "L1_C75SS1-0";
region1.memory_region[2].$name               = "L2RAM_C7x_2_AUX_AS_L1";
region1.memory_region[2].size                = 0x4000;
region1.memory_region[2].auto                = false;
region1.memory_region[3].type                = "DDR_LOW_ALL";
region1.memory_region[3].$name               = "DDR_C7x_2_IPC";
region1.memory_region[3].size                = 0x100000;
region1.memory_region[3].auto                = false;
region1.memory_region[3].manualStartAddress  = 0xB1000000;
region1.memory_region[4].type                = "DDR_LOW_ALL";
region1.memory_region[4].$name               = "DDR_C7x_2_RESOURCE_TABLE";
region1.memory_region[4].size                = 0x400;
region1.memory_region[4].auto                = false;
region1.memory_region[4].manualStartAddress  = 0xB1100000;
region1.memory_region[5].type                = "DDR_LOW_ALL";
region1.memory_region[5].$name               = "DDR_C7x_2_IPC_TRACE";
region1.memory_region[5].size                = 0xFFC00;
region1.memory_region[5].auto                = false;
region1.memory_region[5].manualStartAddress  = 0xB1100400;
region1.memory_region[6].type                = "DDR_LOW_ALL";
region1.memory_region[6].$name               = "DDR_C7x_2_BOOT";
region1.memory_region[6].size                = 0x400;
region1.memory_region[6].auto                = false;
region1.memory_region[6].manualStartAddress  = 0xB1200000;
region1.memory_region[7].type                = "DDR_LOW_ALL";
region1.memory_region[7].$name               = "DDR_C7x_2_VECS";
region1.memory_region[7].size                = 0x4000;
region1.memory_region[7].auto                = false;
region1.memory_region[7].manualStartAddress  = 0xB1400000;
region1.memory_region[8].type                = "DDR_LOW_ALL";
region1.memory_region[8].$name               = "DDR_C7x_2_SECURE_VECS";
region1.memory_region[8].size                = 0x4000;
region1.memory_region[8].auto                = false;
region1.memory_region[8].manualStartAddress  = 0xB1600000;
region1.memory_region[9].type                = "DDR_LOW_ALL";
region1.memory_region[9].$name               = "DDR_C7x_2";
region1.memory_region[9].size                = 0x39FC000;
region1.memory_region[9].auto                = false;
region1.memory_region[9].manualStartAddress  = 0xB1604000;
region1.memory_region[10].$name              = "DDR_C7X_2_LOCAL_HEAP_NON_CACHEABLE";
region1.memory_region[10].size               = 0x4000000;
region1.memory_region[10].auto               = false;
region1.memory_region[10].addressType        = "Virtual";
region1.memory_region[10].manualStartAddress = 0x110000000;
region1.memory_region[11].$name              = "DDR_C7X_2_SCRATCH_NON_CACHEABLE";
region1.memory_region[11].size               = 0x4000000;
region1.memory_region[11].auto               = false;
region1.memory_region[11].addressType        = "Virtual";
region1.memory_region[11].manualStartAddress = 0x114000000;
region1.memory_region[12].$name              = "DDR_C7X_2_LOCAL_HEAP";
region1.memory_region[12].size               = 0x4000000;
region1.memory_region[12].auto               = false;
region1.memory_region[12].addressType        = "Virtual";
region1.memory_region[12].manualStartAddress = 0x118000000;
region1.memory_region[13].$name              = "DDR_C7X_2_SCRATCH";
region1.memory_region[13].size               = 0x4000000;
region1.memory_region[13].auto               = false;
region1.memory_region[13].addressType        = "Virtual";
region1.memory_region[13].manualStartAddress = 0x11C000000;
region1.memory_region[14].$name              = "DDR_C7X_2_1_LOCAL_HEAP_NON_CACHEABLE";
region1.memory_region[14].size               = 0x4000000;
region1.memory_region[14].auto               = false;
region1.memory_region[14].addressType        = "Virtual";
region1.memory_region[14].manualStartAddress = 0x100000000;
region1.memory_region[15].$name              = "DDR_C7X_2_1_SCRATCH_NON_CACHEABLE";
region1.memory_region[15].size               = 0x4000000;
region1.memory_region[15].auto               = false;
region1.memory_region[15].addressType        = "Virtual";
region1.memory_region[15].manualStartAddress = 0x104000000;
region1.memory_region[16].$name              = "DDR_C7X_2_1_LOCAL_HEAP";
region1.memory_region[16].size               = 0x4000000;
region1.memory_region[16].auto               = false;
region1.memory_region[16].addressType        = "Virtual";
region1.memory_region[16].manualStartAddress = 0x108000000;
region1.memory_region[17].$name              = "DDR_C7X_2_1_SCRATCH";
region1.memory_region[17].size               = 0x4000000;
region1.memory_region[17].auto               = false;
region1.memory_region[17].addressType        = "Virtual";
region1.memory_region[17].manualStartAddress = 0x10C000000;
