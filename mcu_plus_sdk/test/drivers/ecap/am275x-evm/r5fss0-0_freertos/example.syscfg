/**
 * @cliArgs --device "AM275x" --package "ANJ" --part "AM2754" --context "r5fss0-0" --product "MCU_PLUS_SDK@07.03.01"
 * @versions {"tool":"1.20.0+3587"}
 */

/**
 * Import the modules used in this configuration.
 */
const ecap       = scripting.addModule("/drivers/ecap/ecap", {}, false);
const ecap1      = ecap.addInstance();
const ecap2      = ecap.addInstance();
const epwm       = scripting.addModule("/drivers/epwm/epwm", {}, false);
const epwm1      = epwm.addInstance();
const clock      = scripting.addModule("/kernel/dpl/clock");
const debug_log  = scripting.addModule("/kernel/dpl/debug_log");
const mpu_armv7  = scripting.addModule("/kernel/dpl/mpu_armv7", {}, false);
const mpu_armv71 = mpu_armv7.addInstance();
const mpu_armv72 = mpu_armv7.addInstance();
const mpu_armv73 = mpu_armv7.addInstance();
const mpu_armv74 = mpu_armv7.addInstance();
const mpu_armv75 = mpu_armv7.addInstance();
const mpu_armv76 = mpu_armv7.addInstance();

/**
 * Write custom configuration values to the imported modules.
 */
ecap1.$name                    = "CONFIG_ECAP0";
ecap1.ECAP.IN_APWM_OUT.$assign = "EXT_REFCLK1";

ecap2.$name = "CONFIG_ECAP1";

epwm1.$name            = "CONFIG_EPWM0";
epwm1.EPWM.B.$used     = false;
epwm1.EPWM.SYNCO.$used = false;
epwm1.EPWM.SYNCI.$used = false;

debug_log.enableUartLog = true;
debug_log.uartLog.$name = "CONFIG_UART0";

mpu_armv71.accessPermissions = "Supervisor RD+WR, User RD";
mpu_armv71.allowExecute      = false;
mpu_armv71.size              = 31;
mpu_armv71.attributes        = "Device";
mpu_armv71.$name             = "REGISTER_REGION";

mpu_armv72.accessPermissions = "Supervisor RD+WR, User RD";
mpu_armv72.size              = 7;
mpu_armv72.$name             = "TCMA_VEC";

mpu_armv73.$name    = "DDR";
mpu_armv73.baseAddr = 0x90000000;
mpu_armv73.size     = 28;

mpu_armv74.baseAddr   = 0x41010000;
mpu_armv74.size       = 15;
mpu_armv74.attributes = "NonCached";
mpu_armv74.$name      = "TCMB";

mpu_armv75.size       = 15;
mpu_armv75.attributes = "NonCached";
mpu_armv75.$name      = "TCMA";

mpu_armv76.baseAddr = 0x43C00000;
mpu_armv76.size     = 18;
mpu_armv76.$name    = "HSM_RAM";

/**
 * Pinmux solution for unlocked pins/peripherals. This ensures that minor changes to the automatic solver in a future
 * version of the tool will not impact the pinmux you originally saw.  These lines can be completely deleted in order to
 * re-solve from scratch.
 */
ecap1.ECAP.$suggestSolution                 = "ECAP0";
ecap2.ECAP.$suggestSolution                 = "ECAP1";
ecap2.ECAP.IN_APWM_OUT.$suggestSolution     = "I2C0_SCL";
epwm1.EPWM.$suggestSolution                 = "EPWM0";
epwm1.EPWM.A.$suggestSolution               = "MMC0_DAT4";
debug_log.uartLog.UART.$suggestSolution     = "UART0";
debug_log.uartLog.UART.RXD.$suggestSolution = "MCASP4_AXR0";
debug_log.uartLog.UART.TXD.$suggestSolution = "MLB0_MLBCLK";
