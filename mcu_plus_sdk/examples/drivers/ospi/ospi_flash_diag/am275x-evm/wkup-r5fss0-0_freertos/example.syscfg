/**
 * @cliArgs --device "AM275x" --part "AM2754" --package "ANJ" --context "wkup-r5fss0-0" --product "MCU_PLUS_SDK@07.03.01"
 * @versions {"tool":"1.21.0+3721"}
 */

/**
 * Import the modules used in this configuration.
 */
const ospi            = scripting.addModule("/drivers/ospi/ospi", {}, false);
const ospi1           = ospi.addInstance();
const addr_translate  = scripting.addModule("/kernel/dpl/addr_translate", {}, false);
const addr_translate1 = addr_translate.addInstance();
const debug_log       = scripting.addModule("/kernel/dpl/debug_log");
const mpu_armv7       = scripting.addModule("/kernel/dpl/mpu_armv7", {}, false);
const mpu_armv71      = mpu_armv7.addInstance();
const mpu_armv72      = mpu_armv7.addInstance();
const mpu_armv73      = mpu_armv7.addInstance();
const mpu_armv74      = mpu_armv7.addInstance();
const mpu_armv75      = mpu_armv7.addInstance();

/**
 * Write custom configuration values to the imported modules.
 */
ospi1.$name        = "CONFIG_OSPI0";
ospi1.inputClkFreq = 20000000;
ospi1.baudRateDiv  = 2;
ospi1.OSPI.$assign = "OSPI0";

addr_translate1.localAddr  = 0x60000000;
addr_translate1.size       = 26;
addr_translate1.systemAddr = 0x500000000;
addr_translate1.$name      = "FSS0_DAT_REG3";

debug_log.enableUartLog                      = true;
debug_log.uartLog.$name                      = "CONFIG_UART0";
debug_log.uartLog.useWakeupDomainPeripherals = true;
debug_log.uartLog.WKUP_UART.$assign          = "WKUP_UART";

mpu_armv71.size         = 31;
mpu_armv71.attributes   = "Device";
mpu_armv71.allowExecute = false;
mpu_armv71.$name        = "REGISTERS";

mpu_armv72.size  = 15;
mpu_armv72.$name = "TCMA";

mpu_armv73.baseAddr = 0x41010000;
mpu_armv73.size     = 15;
mpu_armv73.$name    = "TCMB";

mpu_armv74.$name    = "MSRAM_BANK0_TO_BANK3";
mpu_armv74.baseAddr = 0x72000000;
mpu_armv74.size     = 22;

mpu_armv75.$name    = "MSRAM_BANK4_TO_BANK5";
mpu_armv75.baseAddr = 0x72400000;
mpu_armv75.size     = 21;

/**
 * Pinmux solution for unlocked pins/peripherals. This ensures that minor changes to the automatic solver in a future
 * version of the tool will not impact the pinmux you originally saw.  These lines can be completely deleted in order to
 * re-solve from scratch.
 */
ospi1.OSPI.CLK.$suggestSolution                  = "OSPI0_CLK";
ospi1.OSPI.CSn0.$suggestSolution                 = "OSPI0_CSn0";
ospi1.OSPI.DQS.$suggestSolution                  = "OSPI0_DQS";
ospi1.OSPI.D7.$suggestSolution                   = "OSPI0_D7";
ospi1.OSPI.D6.$suggestSolution                   = "OSPI0_D6";
ospi1.OSPI.D5.$suggestSolution                   = "OSPI0_D5";
ospi1.OSPI.D4.$suggestSolution                   = "OSPI0_D4";
ospi1.OSPI.D3.$suggestSolution                   = "OSPI0_D3";
ospi1.OSPI.D2.$suggestSolution                   = "OSPI0_D2";
ospi1.OSPI.D1.$suggestSolution                   = "OSPI0_D1";
ospi1.OSPI.D0.$suggestSolution                   = "OSPI0_D0";
debug_log.uartLog.WKUP_UART.RXD.$suggestSolution = "WKUP_UART0_RXD";
debug_log.uartLog.WKUP_UART.TXD.$suggestSolution = "WKUP_UART0_TXD";
