/**
 * @cliArgs --device "AM275x" --part "AM2754" --package "ANJ" --context "r5fss0-0" --product "MCU_PLUS_SDK@07.03.01"
 * @versions {"tool":"1.22.0+3893"}
 */

/**
 * Import the modules used in this configuration.
 */
const i2c        = scripting.addModule("/drivers/i2c/i2c", {}, false);
const i2c1       = i2c.addInstance();
const mcasp      = scripting.addModule("/drivers/mcasp/mcasp", {}, false);
const mcasp1     = mcasp.addInstance();
const clock      = scripting.addModule("/kernel/dpl/clock");
const debug_log  = scripting.addModule("/kernel/dpl/debug_log");
const mpu_armv7  = scripting.addModule("/kernel/dpl/mpu_armv7", {}, false);
const mpu_armv71 = mpu_armv7.addInstance();
const mpu_armv72 = mpu_armv7.addInstance();
const mpu_armv73 = mpu_armv7.addInstance();
const mpu_armv74 = mpu_armv7.addInstance();
const mpu_armv75 = mpu_armv7.addInstance();
const mpu_armv76 = mpu_armv7.addInstance();

/**
 * Write custom configuration values to the imported modules.
 */
i2c1.$name           = "CONFIG_I2C0";
i2c1.I2C.$assign     = "I2C0";
i2c1.I2C_child.$name = "drivers_i2c_v0_i2c_v0_template0";

mcasp1.$name                                   = "CONFIG_MCASP0";
mcasp1.enableLoopback                          = false;
mcasp1.txCallbackFxn                           = "mcasp_txcb";
mcasp1.rxCallbackFxn                           = "mcasp_rxcb";
mcasp1.rxDataMask                              = 0xFFFFFFFF;
mcasp1.TxMode                                  = "TDM";
mcasp1.NumTxSlots                              = 8;
mcasp1.txActiveSlotMask                        = 0xFF;
mcasp1.RxMode                                  = "TDM";
mcasp1.NumRxSlots                              = 8;
mcasp1.rxActiveSlotMask                        = 0xFF;
mcasp1.rxFsWidth                               = 0;
mcasp1.txFsWidth                               = 0;
mcasp1.rxFsPolarity                            = 0;
mcasp1.rxBitClkPolarity                        = 0;
mcasp1.txFsPolarity                            = 0;
mcasp1.rxHclkSourceMux                         = 4;
mcasp1.enableMcaspRx                           = false;
mcasp1.txDataDelay                             = 0;
mcasp1.masterClkx                              = 256;
mcasp1.clkSyncMode                             = "ASYNC";
mcasp1.txDataMask                              = 0xFFFFFFFF;
mcasp1.txLoopjobBufLength                      = 384000;
mcasp1.MCASP.$assignAllowConflicts             = "MCASP0";
mcasp1.MCASP.ACLKX.pu_pd                       = "pu";
mcasp1.mcaspSer.create(1);
mcasp1.mcaspSer[0].$name                       = "CONFIG_MCASP_SER0";
mcasp1.mcaspSer[0].MCASP.$assignAllowConflicts = "MCASP0";

const udma         = scripting.addModule("/drivers/udma/udma", {}, false);
const udma1        = udma.addInstance({}, false);
udma1.$name        = "CONFIG_UDMA0";
mcasp1.bcDmaDriver = udma1;

debug_log.enableUartLog            = true;
debug_log.uartLog.$name            = "CONFIG_UART0";
debug_log.uartLog.UART.$assign     = "UART0";
debug_log.uartLog.UART.RXD.$assign = "UART0_RXD";
debug_log.uartLog.UART.TXD.$assign = "UART0_TXD";

mpu_armv71.size         = 31;
mpu_armv71.attributes   = "Device";
mpu_armv71.allowExecute = false;
mpu_armv71.$name        = "REGISTERS";

mpu_armv72.size  = 15;
mpu_armv72.$name = "TCMA";

mpu_armv73.baseAddr = 0x41010000;
mpu_armv73.size     = 15;
mpu_armv73.$name    = "TCMB";

mpu_armv74.size     = 22;
mpu_armv74.baseAddr = 0x72000000;
mpu_armv74.$name    = "MSRAM_BANK0_TO_BANK3";

mpu_armv75.baseAddr = 0x72400000;
mpu_armv75.size     = 21;
mpu_armv75.$name    = "MSRAM_BANK4_TO_BANK5";

mpu_armv76.$name        = "MCASP1";
mpu_armv76.baseAddr     = 0x2B10000;
mpu_armv76.size         = 13;
mpu_armv76.attributes   = "Device";
mpu_armv76.allowExecute = false;

/**
 * Pinmux solution for unlocked pins/peripherals. This ensures that minor changes to the automatic solver in a future
 * version of the tool will not impact the pinmux you originally saw.  These lines can be completely deleted in order to
 * re-solve from scratch.
 */
i2c1.I2C.SCL.$suggestSolution                  = "I2C0_SCL";
i2c1.I2C.SDA.$suggestSolution                  = "I2C0_SDA";
mcasp1.MCASP.AFSX.$suggestSolution             = "MCASP0_AFSX";
mcasp1.MCASP.ACLKX.$suggestSolution            = "MCASP0_ACLKX";
mcasp1.CLOCKING.$suggestSolution               = "CLOCKING";
mcasp1.mcaspSer[0].MCASP.AXR0.$suggestSolution = "MCASP0_AXR0";
