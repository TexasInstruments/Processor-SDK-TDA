/**
 * @cliArgs --device "AM62x" --package "ALW" --part "Default" --context "a53ss0-0" --product "MCU_PLUS_SDK@07.03.01"
 * @versions {"tool":"1.20.0+3587"}
 */

/**
 * Import the modules used in this configuration.
 */
const dss        = scripting.addModule("/drivers/dss/dss", {}, false);
const dss1       = dss.addInstance();
const clock      = scripting.addModule("/kernel/dpl/clock");
const debug_log  = scripting.addModule("/kernel/dpl/debug_log");
const mmu_armv8  = scripting.addModule("/kernel/dpl/mmu_armv8", {}, false);
const mmu_armv81 = mmu_armv8.addInstance();
const mmu_armv82 = mmu_armv8.addInstance();
const mmu_armv83 = mmu_armv8.addInstance();
const mmu_armv84 = mmu_armv8.addInstance();

/**
 * Write custom configuration values to the imported modules.
 */
dss1.$name                                   = "CONFIG_DSS0";
dss1.vpSafetyConfig                          = "true";
dss1.vidSafetyConfig                         = "true";
dss1.vidlSafetyConfig                        = "true";
dss1.dssVPSafetyConfig.create(4);
dss1.dssVPSafetyConfig[0].$name              = "drivers_dss_v0_dss_safety_v02";
dss1.dssVPSafetyConfig[0].widthSafetyRegion  = 40;
dss1.dssVPSafetyConfig[0].heightSafetyRegion = 30;
dss1.dssVPSafetyConfig[1].$name              = "drivers_dss_v0_dss_safety_v03";
dss1.dssVPSafetyConfig[1].widthSafetyRegion  = 80;
dss1.dssVPSafetyConfig[1].heightSafetyRegion = 60;
dss1.dssVPSafetyConfig[1].regionXstart       = 100;
dss1.dssVPSafetyConfig[1].regionYstart       = 100;
dss1.dssVPSafetyConfig[2].$name              = "drivers_dss_v0_dss_safety_v00";
dss1.dssVPSafetyConfig[2].regionXstart       = 1440;
dss1.dssVPSafetyConfig[2].regionYstart       = 840;
dss1.dssVPSafetyConfig[2].widthSafetyRegion  = 40;
dss1.dssVPSafetyConfig[2].heightSafetyRegion = 20;
dss1.dssVPSafetyConfig[2].safetyCheckMode    = "DATA_INTEGRITY";
dss1.dssVPSafetyConfig[2].referenceSign      = 0x709404A5;
dss1.dssVPSafetyConfig[3].$name              = "drivers_dss_v0_dss_safety_v01";
dss1.dssVPSafetyConfig[3].safetyCheckMode    = "DATA_INTEGRITY";
dss1.dssVPSafetyConfig[3].referenceSign      = 0x2F469430;
dss1.dssVPSafetyConfig[3].regionXstart       = 1640;
dss1.dssVPSafetyConfig[3].regionYstart       = 920;
dss1.dssVPSafetyConfig[3].widthSafetyRegion  = 60;
dss1.dssVPSafetyConfig[3].heightSafetyRegion = 40;
dss1.dssVIDSafetyConfig[0].$name             = "drivers_dss_v0_dss_safety_v04";
dss1.dssVIDSafetyConfig[0].thresholdValue    = 50;
dss1.dssVIDLSafetyConfig[0].$name            = "drivers_dss_v0_dss_safety_v05";
dss1.dssVIDLSafetyConfig[0].safetyCheckMode  = "DATA_INTEGRITY";
dss1.dssVIDLSafetyConfig[0].referenceSign    = 0xC9654F7E;

debug_log.enableUartLog        = true;
debug_log.uartLog.$name        = "CONFIG_UART0";
debug_log.uartLog.UART.$assign = "USART0";

mmu_armv81.$name = "SOC_MEM_REGION";
mmu_armv81.size  = 0x80000000;

mmu_armv82.$name             = "ATF_REGION";
mmu_armv82.vAddr             = 0x80000000;
mmu_armv82.pAddr             = 0x80000000;
mmu_armv82.size              = 0x80000;
mmu_armv82.accessPermissions = "Privilege RO, User None";
mmu_armv82.shareable         = "Non Shareable";

mmu_armv83.size      = 0x80000000;
mmu_armv83.attribute = "MAIR7";
mmu_armv83.$name     = "DDR_REGION";
mmu_armv83.vAddr     = 0x80080000;
mmu_armv83.pAddr     = 0x80080000;

mmu_armv84.$name     = "DDR_FRAMEBUFFER";
mmu_armv84.vAddr     = 0x93500000;
mmu_armv84.pAddr     = 0x93500000;
mmu_armv84.size      = 0x8000000;
mmu_armv84.attribute = "MAIR7";

/**
 * Pinmux solution for unlocked pins/peripherals. This ensures that minor changes to the automatic solver in a future
 * version of the tool will not impact the pinmux you originally saw.  These lines can be completely deleted in order to
 * re-solve from scratch.
 */
dss1.DSS.$suggestSolution                   = "DSS0";
debug_log.uartLog.UART.RXD.$suggestSolution = "UART0_RXD";
debug_log.uartLog.UART.TXD.$suggestSolution = "UART0_TXD";
