/**
 * @cliArgs --device "J722S_TDA4VEN_TDA4AEN_AM67" --package "AMW" --part "Default" --context "c75ss0-0" --product "MCU_PLUS_SDK@07.03.01"
 * @versions {"tool":"1.20.0+3587"}
 */

/**
 * Import the modules used in this configuration.
 */
const debug_log  = scripting.addModule("/kernel/dpl/debug_log");
const mmu_armv8  = scripting.addModule("/kernel/dpl/mmu_armv8", {}, false);
const mmu_armv81 = mmu_armv8.addInstance();
const mmu_armv82 = mmu_armv8.addInstance();
const mmu_armv83 = mmu_armv8.addInstance();
const mmu_armv84 = mmu_armv8.addInstance();
const mmu_armv85 = mmu_armv8.addInstance();
const mmu_armv86 = mmu_armv8.addInstance();
const mmu_armv87 = mmu_armv8.addInstance();
const mmu_armv88 = mmu_armv8.addInstance();
const default_linker  = scripting.addModule("/memory_configurator/default_linker", {}, false);
const default_linker1 = default_linker.addInstance();
const region          = scripting.addModule("/memory_configurator/region", {}, false);
const region1         = region.addInstance();

/**
 * Write custom configuration values to the imported modules.
 */
debug_log.enableUartLog        = true;
debug_log.uartLog.$name        = "CONFIG_UART0";
debug_log.uartLog.UART.$assign = "USART0";

/**
 * Register region 0.
 * Region start: 0x0
 * Region end: 0x20000000
 * Read and write for both privileged and user modes.
 * No Execute for both privileged and user modes.
 * Attribute is MAIR0.
 */
mmu_armv81.vAddr             = 0x00000000;
mmu_armv81.pAddr             = 0x00000000;
mmu_armv81.size              = 0x20000000;
mmu_armv81.$name             = "REGISTER_REGION_0";
mmu_armv81.accessPermissions = "Privilege RW, User RW";
mmu_armv81.privExecute       = false;
mmu_armv81.userExecute       = false;
mmu_armv81.attribute = "MAIR0";

/**
 * Register region 1.
 * Region start: 0x20000000
 * Region end: 0x40000000
 * Read and write for both privileged and user modes.
 * No Execute for both privileged and user modes.
 * Attribute is MAIR0.
 */
mmu_armv82.vAddr             = 0x20000000;
mmu_armv82.pAddr             = 0x20000000;
mmu_armv82.size              = 0x20000000;
mmu_armv82.$name             = "REGISTER_REGION_1";
mmu_armv82.accessPermissions = "Privilege RW, User RW";
mmu_armv82.privExecute       = false;
mmu_armv82.userExecute       = false;
mmu_armv82.attribute         = "MAIR0";

/**
 * Register region 2.
 * Region start: 0x40000000
 * Region end: 0x60000000
 * Read and write for both privileged and user modes.
 * No Execute for both privileged and user modes.
 * Attribute is MAIR0.
 */
mmu_armv83.vAddr             = 0x40000000;
mmu_armv83.pAddr             = 0x40000000;
mmu_armv83.size              = 0x20000000;
mmu_armv83.$name             = "REGISTER_REGION_2";
mmu_armv83.accessPermissions = "Privilege RW, User RW";
mmu_armv83.privExecute       = false;
mmu_armv83.userExecute       = false;
mmu_armv83.attribute         = "MAIR0";

/**
 * FSS region.
 * Region start: 0x60000000
 * Region end: 0x64000000
 * Read and write for both privileged and user modes.
 * No Execute for both privileged and user modes.
 * Attribute is MAIR0.
 */
mmu_armv84.vAddr             = 0x60000000;
mmu_armv84.pAddr             = 0x60000000;
mmu_armv84.size              = 0x4000000;
mmu_armv84.$name             = "FSS0_DAT_REGION";
mmu_armv84.accessPermissions = "Privilege RW, User RW";
mmu_armv84.privExecute       = false;
mmu_armv84.userExecute       = false;
mmu_armv84.attribute         = "MAIR0";

/**
 * CLEC region.
 * Region start: 0x7C200000
 * Region end: 0x7C300000
 * Read and write for both privileged and user modes.
 * No Execute for both privileged and user modes.
 * Attribute is MAIR0.
 */
mmu_armv85.vAddr             = 0x7C200000;
mmu_armv85.pAddr             = 0x7C200000;
mmu_armv85.$name             = "CLEC";
mmu_armv85.accessPermissions = "Privilege RW, User RW";
mmu_armv85.size              = 0x100000;
mmu_armv85.privExecute       = false;
mmu_armv85.userExecute       = false;
mmu_armv85.attribute         = "MAIR0";

/**
 * DRU region.
 * Region start: 0x7C400000
 * Region end: 0x7C500000
 * Read and write for both privileged and user modes.
 * No Execute for both privileged and user modes.
 * Attribute is MAIR0.
 */
mmu_armv86.$name             = "DRU";
mmu_armv86.vAddr             = 0x7C400000;
mmu_armv86.pAddr             = 0x7C400000;
mmu_armv86.size              = 0x100000;
mmu_armv86.accessPermissions = "Privilege RW, User RW";
mmu_armv86.privExecute       = false;
mmu_armv86.userExecute       = false;
mmu_armv86.attribute         = "MAIR0";

/**
 * DDR region.
 * Region start: 0x80000000
 * Region end: 0xFFFFFFFF
 * Read and write for both privileged and user modes.
 * Execute for both privileged and user modes.
 * Attribute is MAIR7.
 */
mmu_armv87.vAddr       = 0x80000000;
mmu_armv87.pAddr       = 0x80000000;
mmu_armv87.size        = 0x80000000;
mmu_armv87.attribute   = "MAIR7";
mmu_armv87.$name       = "DDR_0";
mmu_armv87.privExecute = true;
mmu_armv87.userExecute = true;

mmu_armv88.vAddr     = 0xA3410000;
mmu_armv88.pAddr     = 0xA3410000;
mmu_armv88.size      = 0x1000;
mmu_armv88.attribute = "MAIR4";
mmu_armv88.$name     = "CCS_DEBUG_LOG_MEM";

default_linker1.$name = "memory_configurator_default_linker0";

region1.$name                               = "MEMORY_REGION_CONFIGURATION0";
region1.memory_region.create(7);
region1.memory_region[0].auto               = false;
region1.memory_region[0].type               = "L3_C75";
region1.memory_region[0].$name              = "L2SRAM";
region1.memory_region[0].size               = 0x200000;
region1.memory_region[1].type               = "DDR_LOW_ALL";
region1.memory_region[1].auto               = false;
region1.memory_region[1].size               = 0x19800000;
region1.memory_region[1].$name              = "DDR0_RESERVED";
region1.memory_region[2].type               = "DDR_LOW_ALL";
region1.memory_region[2].auto               = false;
region1.memory_region[2].manualStartAddress = 0xA3000000;
region1.memory_region[2].$name              = "C7X_IPC_D";
region1.memory_region[2].size               = 0x100000;
region1.memory_region[3].type               = "DDR_LOW_ALL";
region1.memory_region[3].auto               = false;
region1.memory_region[3].$name              = "C7X_BOOT_D";
region1.memory_region[3].size               = 0x400;
region1.memory_region[3].manualStartAddress = 0xA3200000;
region1.memory_region[4].type               = "DDR_LOW_ALL";
region1.memory_region[4].auto               = false;
region1.memory_region[4].$name              = "C7X_VECS_D";
region1.memory_region[4].size               = 0x4000;
region1.memory_region[4].manualStartAddress = 0xA3400000;
region1.memory_region[5].type               = "DDR_LOW_ALL";
region1.memory_region[5].$name              = "C7X_CIO_MEM";
region1.memory_region[5].auto               = false;
region1.memory_region[5].size               = 0x1000;
region1.memory_region[5].manualStartAddress = 0xA3410000;
region1.memory_region[6].type               = "DDR_LOW_ALL";
region1.memory_region[6].$name              = "C7X_DDR_SPACE";
region1.memory_region[6].auto               = false;
region1.memory_region[6].manualStartAddress = 0xA3411000;
region1.memory_region[6].size               = 0xBEF000;

/**
 * Pinmux solution for unlocked pins/peripherals. This ensures that minor changes to the automatic solver in a future
 * version of the tool will not impact the pinmux you originally saw.  These lines can be completely deleted in order to
 * re-solve from scratch.
 */
debug_log.uartLog.UART.RXD.$suggestSolution = "UART0_RXD";
debug_log.uartLog.UART.TXD.$suggestSolution = "UART0_TXD";
