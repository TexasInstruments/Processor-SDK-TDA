/*
 * This file is AUTO GENERATED by SysConfig Memory Configurator tool.
 * It is NOT recommended to manually edit this file.
 *
 * IMPORTANT NOTE: Follow the below instructions to apply the updated memory map to the linux dtsi file,
 *
 * 1. Copy the contents of the generated k3-j722s-rtos-memory-map.dtsi file and replace the
 *      reserved_memory section of the k3-j722s-rtos-memory-map.dtsi file that is located here:
 *      PSDK_LINUX_PATH/board-support/linux*/arch/arm64/boot/dts/ti
 *
 * 2. Rebuild the dtb and dtbo from the PSDK_LINUX_PATH directory with the following:
 *      make linux-dtbs
 *
 * 3. Install the dtb and dtbo to the rootfs/boot folder on the SD card from the same directory with the following:
 *      sudo make linux-dtbs_install; sync
 */

  /* !! DTSI GENERATION ERRORS - OUTPUT IS INCOMPLETE !!
   * ERROR: DDR_SHARED_MEM physical address not found — no MMU/addr_translate entry maps 0x-1
   * ERROR: region 'DDR_MCU1_0_IPC' not found — check region name in SysConfig
   * ERROR: region 'DDR_MCU2_0_IPC' not found — check region name in SysConfig
   * ERROR: region 'DDR_C7x_1_IPC' not found — check region name in SysConfig
   * ERROR: region 'DDR_C7x_2_IPC' not found — check region name in SysConfig
   * ERROR: region 'DDR_MCU1_0_RESOURCE_TABLE' not found — check region name in SysConfig
   * ERROR: region 'DDR_MCU2_0_RESOURCE_TABLE' not found — check region name in SysConfig
   * ERROR: region 'IPC_VRING_MEM' not found — check region name in SysConfig
   * ERROR: region 'APP_LOG_MEM' not found — check region name in SysConfig
   * ERROR: region 'DDR_C7x_1_RESOURCE_TABLE' not found — check region name in SysConfig
   * ERROR: region 'DDR_C7x_2_RESOURCE_TABLE' not found — check region name in SysConfig
   * ERROR: region 'DDR_MCU1_0_LOCAL_HEAP' not found — check region name in SysConfig
   * ERROR: region 'INTERCORE_ETH_DESC_MEM' not found — check region name in SysConfig
   * ERROR: region 'INTERCORE_ETH_DATA_MEM' not found — check region name in SysConfig
   * Fix: ensure all required region names exist in SysConfig and match the
   * lookup table in linux_rtos_memory_map.xdt
   */
	c7x_ddr_heaps_hi: c7x-ddr-heaps-hi@880000000 {
		compatible = "shared-dma-pool";
		reg = <0x08 0x80000000 0x00 0x20000000>;
		no-map;
	};

