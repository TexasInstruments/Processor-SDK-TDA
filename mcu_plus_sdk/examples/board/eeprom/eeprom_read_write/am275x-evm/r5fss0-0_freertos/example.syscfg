/**
 * @cliArgs --device "AM275x" --part "AM2754" --package "ANJ" --context "r5fss0-0" --product "MCU_PLUS_SDK@07.03.01"
 * @versions {"tool":"1.21.0+3721"}
 */

/**
 * Import the modules used in this configuration.
 */
const eeprom     = scripting.addModule("/board/eeprom/eeprom", {}, false);
const eeprom1    = eeprom.addInstance();
const i2c        = scripting.addModule("/drivers/i2c/i2c", {}, false);
const i2c1       = i2c.addInstance();
const debug_log  = scripting.addModule("/kernel/dpl/debug_log");
const mpu_armv7  = scripting.addModule("/kernel/dpl/mpu_armv7", {}, false);
const mpu_armv71 = mpu_armv7.addInstance();
const mpu_armv72 = mpu_armv7.addInstance();
const mpu_armv73 = mpu_armv7.addInstance();
const mpu_armv74 = mpu_armv7.addInstance();
const mpu_armv75 = mpu_armv7.addInstance();
const mpu_armv76 = mpu_armv7.addInstance();
const mpu_armv77 = mpu_armv7.addInstance();
const mpu_armv78 = mpu_armv7.addInstance();

/**
 * Write custom configuration values to the imported modules.
 */
eeprom1.$name      = "CONFIG_EEPROM0";
eeprom1.i2cAddress = 0x54;

i2c1.$name               = "CONFIG_I2C0";
eeprom1.peripheralDriver = i2c1;
i2c1.I2C.$assign         = "I2C0";
i2c1.I2C_child.$name     = "drivers_i2c_v0_i2c_v0_template0";

debug_log.enableUartLog            = true;
debug_log.uartLog.$name            = "CONFIG_UART0";
debug_log.uartLog.UART.RXD.$assign = "UART0_RXD";
debug_log.uartLog.UART.TXD.$assign = "UART0_TXD";

mpu_armv71.size         = 31;
mpu_armv71.attributes   = "Device";
mpu_armv71.allowExecute = false;
mpu_armv71.$name        = "CONFIG_MPU_REGISTER";

mpu_armv72.size       = 15;
mpu_armv72.$name      = "CONFIG_MPU_TCMA";
mpu_armv72.attributes = "NonCached";

mpu_armv73.baseAddr   = 0x41010000;
mpu_armv73.size       = 15;
mpu_armv73.$name      = "CONFIG_MPU_TCMB";
mpu_armv73.attributes = "NonCached";

mpu_armv74.baseAddr = 0x79100000;
mpu_armv74.size     = 19;
mpu_armv74.$name    = "CONFIG_MPU_MCU_MSRAM";

mpu_armv75.baseAddr = 0x80000000;
mpu_armv75.size     = 31;
mpu_armv75.$name    = "CONFIG_MPU_DDR";

mpu_armv76.baseAddr = 0x60000000;
mpu_armv76.size     = 26;
mpu_armv76.$name    = "CONFIG_MPU_FLASH";

mpu_armv77.$name    = "MSRAM_BANK0_TO_BANK3";
mpu_armv77.baseAddr = 0x72000000;
mpu_armv77.size     = 22;

mpu_armv78.$name    = "MSRAM_BANK4_TO_BANK5";
mpu_armv78.baseAddr = 0x72400000;
mpu_armv78.size     = 21;

/**
 * Pinmux solution for unlocked pins/peripherals. This ensures that minor changes to the automatic solver in a future
 * version of the tool will not impact the pinmux you originally saw.  These lines can be completely deleted in order to
 * re-solve from scratch.
 */
i2c1.I2C.SCL.$suggestSolution           = "I2C0_SCL";
i2c1.I2C.SDA.$suggestSolution           = "I2C0_SDA";
debug_log.uartLog.UART.$suggestSolution = "UART0";
