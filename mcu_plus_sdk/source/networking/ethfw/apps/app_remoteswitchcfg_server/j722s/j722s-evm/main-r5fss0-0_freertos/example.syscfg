/**
 * @cliArgs --device "J722S_TDA4VEN_TDA4AEN_AM67" --part "Default" --package "AMW" --context "main-r5fss0-0" --product "MCU_PLUS_SDK@07.03.01"
 * @versions {"tool":"1.26.2+4477"}
 */

/**
 * Import the modules used in this configuration.
 */
const ethphy_cpsw_icssg  = scripting.addModule("/board/ethphy_cpsw_icssg/ethphy_cpsw_icssg", {}, false);
const ethphy_cpsw_icssg1 = ethphy_cpsw_icssg.addInstance();
const i2c                = scripting.addModule("/drivers/i2c/i2c", {}, false);
const i2c1               = i2c.addInstance();
const ipc                = scripting.addModule("/drivers/ipc/ipc");
const udma               = scripting.addModule("/drivers/udma/udma", {}, false);
const udma1              = udma.addInstance();
const debug_log          = scripting.addModule("/kernel/dpl/debug_log");
const mpu_armv7          = scripting.addModule("/kernel/dpl/mpu_armv7", {}, false);
const mpu_armv71         = mpu_armv7.addInstance();
const mpu_armv72         = mpu_armv7.addInstance();
const mpu_armv73         = mpu_armv7.addInstance();
const mpu_armv74         = mpu_armv7.addInstance();
const mpu_armv75         = mpu_armv7.addInstance();
const mpu_armv76         = mpu_armv7.addInstance();
const mpu_armv77         = mpu_armv7.addInstance();
const mpu_armv78         = mpu_armv7.addInstance();
const mpu_armv79         = mpu_armv7.addInstance();
const enet_cpsw          = scripting.addModule("/networking/enet_cpsw/enet_cpsw", {}, false);
const enet_cpsw1         = enet_cpsw.addInstance();

/**
 * Write custom configuration values to the imported modules.
 */
i2c1.$name                      = "CONFIG_I2C0";
i2c1.useWakeupDomainPeripherals = false;
i2c1.I2C_child.$name            = "drivers_i2c_v0_i2c_v0_template0";
i2c1.I2C.$assign                = "I2C0";
i2c1.I2C.SCL.$assign            = "I2C0_SCL";
i2c1.I2C.SDA.$assign            = "I2C0_SDA";

udma1.$name = "CONFIG_UDMA0";

debug_log.enableUartLog                      = true;
debug_log.uartLog.$name                      = "CONFIG_UART0";
debug_log.uartLog.useWakeupDomainPeripherals = false;
debug_log.uartLog.UART.$assign               = "USART5";
debug_log.uartLog.UART.RXD.$assign           = "MMC2_DAT3";
debug_log.uartLog.UART.TXD.$assign           = "MMC2_DAT2";

mpu_armv71.size              = 31;
mpu_armv71.attributes        = "Device";
mpu_armv71.accessPermissions = "Supervisor RD+WR, User RD";
mpu_armv71.allowExecute      = false;
mpu_armv71.$name             = "CONFIG_MPU_REGISTER";

mpu_armv72.size              = 15;
mpu_armv72.accessPermissions = "Supervisor RD+WR, User RD";
mpu_armv72.$name             = "CONFIG_MPU_TCMA";

mpu_armv73.baseAddr          = 0x41010000;
mpu_armv73.size              = 15;
mpu_armv73.accessPermissions = "Supervisor RD+WR, User RD";
mpu_armv73.$name             = "CONFIG_MPU_TCMB";

mpu_armv74.accessPermissions = "Supervisor RD+WR, User RD";
mpu_armv74.baseAddr          = 0x79100000;
mpu_armv74.size              = 19;
mpu_armv74.$name             = "CONFIG_MPU_MCU_MSRAM";

mpu_armv75.baseAddr = 0x80000000;
mpu_armv75.size     = 31;
mpu_armv75.$name    = "CONFIG_MPU_DDR";

mpu_armv76.baseAddr     = 0xA5000000;
mpu_armv76.size         = 24;
mpu_armv76.$name        = "RTOS_IPC_VRING";
mpu_armv76.allowExecute = false;
mpu_armv76.attributes   = "NonCached";

mpu_armv77.$name      = "INTERCORE_REGION";
mpu_armv77.attributes = "NonCached";
mpu_armv77.baseAddr   = 0xA7000000;
mpu_armv77.size       = 24;

mpu_armv78.$name        = "LINUX_VRING";
mpu_armv78.baseAddr     = 0xA2000000;
mpu_armv78.attributes   = "NonCached";
mpu_armv78.size         = 20;
mpu_armv78.allowExecute = false;

mpu_armv79.attributes   = "NonCached";
mpu_armv79.size         = 20;
mpu_armv79.allowExecute = false;
mpu_armv79.baseAddr     = 0xA2100000;
mpu_armv79.$name        = "RESOURCE_TABLE_AND_TRACE";

enet_cpsw1.$name                               = "CONFIG_ENET_CPSW0";
enet_cpsw1.IsEthFw                             = true;
enet_cpsw1.macAddrConfig                       = "Manual Entry";
enet_cpsw1.LargePoolPktCount                   = 64;
enet_cpsw1.PktInfoOnlyEnable                   = true;
enet_cpsw1.macAddrList                         = "70:ff:76:1d:ec:f2,70:ff:76:1d:ec:e3,70:ff:76:1d:ec:e4";
enet_cpsw1.cpswVlanAwareMode                   = true;
enet_cpsw1.vlanId_hostPort                     = 0x1;
enet_cpsw1.vlanId_macPort1                     = 0x3;
enet_cpsw1.vlanId_macPort2                     = 0x3;
enet_cpsw1.hostportRxMtu                       = 1522;
enet_cpsw1.RGMII1.$assign                      = "RGMII1";
enet_cpsw1.txDmaChannel.create(2);
enet_cpsw1.txDmaChannel[0].$name               = "ENET_DMA_TX_CH0";
enet_cpsw1.txDmaChannel[1].$name               = "ENET_DMA_TX_CH_PTP";
enet_cpsw1.rxDmaChannel.create(3);
enet_cpsw1.rxDmaChannel[0].$name               = "ENET_DMA_RX_CH0";
enet_cpsw1.rxDmaChannel[0].PacketsCount        = 16;
enet_cpsw1.rxDmaChannel[0].useGlobalEvt        = true;
enet_cpsw1.rxDmaChannel[1].$name               = "ENET_DMA_RX_CH1";
enet_cpsw1.rxDmaChannel[1].macAddrCount        = 0;
enet_cpsw1.rxDmaChannel[1].useDefaultFlow      = false;
enet_cpsw1.rxDmaChannel[1].PacketsCount        = 16;
enet_cpsw1.rxDmaChannel[1].useGlobalEvt        = true;
enet_cpsw1.rxDmaChannel[2].$name               = "ENET_DMA_RX_CH_PTP";
enet_cpsw1.rxDmaChannel[2].useDefaultFlow      = false;
enet_cpsw1.rxDmaChannel[2].PacketsCount        = 16;
enet_cpsw1.rxDmaChannel[2].useGlobalEvt        = true;
enet_cpsw1.rxDmaChannel[2].macAddrCount        = 0;
enet_cpsw1.netifInstance.create(1);
enet_cpsw1.netifInstance[0].$name              = "NETIF_INST_ID0";
enet_cpsw1.netifInstance[0].enableProxyArp     = true;
enet_cpsw1.netifInstance[0].proxyArpRxDmaChNum = ["1"];

ethphy_cpsw_icssg1.$name     = "CONFIG_ENET_ETHPHY1";
enet_cpsw1.ethphy2           = ethphy_cpsw_icssg1;
ethphy_cpsw_icssg1.phySelect = "NO-PHY";

const ethphy_cpsw_icssg2 = ethphy_cpsw_icssg.addInstance({}, false);
ethphy_cpsw_icssg2.$name = "CONFIG_ENET_ETHPHY0";
enet_cpsw1.ethphy1       = ethphy_cpsw_icssg2;

const udma2        = udma.addInstance({}, false);
enet_cpsw1.udmaDrv = udma2;

/**
 * Pinmux solution for unlocked pins/peripherals. This ensures that minor changes to the automatic solver in a future
 * version of the tool will not impact the pinmux you originally saw.  These lines can be completely deleted in order to
 * re-solve from scratch.
 */
enet_cpsw1.MDIO.$suggestSolution          = "MDIO0";
enet_cpsw1.MDIO.MDC.$suggestSolution      = "MDIO0_MDC";
enet_cpsw1.MDIO.MDIO.$suggestSolution     = "MDIO0_MDIO";
enet_cpsw1.RGMII1.RD0.$suggestSolution    = "RGMII1_RD0";
enet_cpsw1.RGMII1.RD1.$suggestSolution    = "RGMII1_RD1";
enet_cpsw1.RGMII1.RD2.$suggestSolution    = "RGMII1_RD2";
enet_cpsw1.RGMII1.RD3.$suggestSolution    = "RGMII1_RD3";
enet_cpsw1.RGMII1.RX_CTL.$suggestSolution = "RGMII1_RX_CTL";
enet_cpsw1.RGMII1.RXC.$suggestSolution    = "RGMII1_RXC";
enet_cpsw1.RGMII1.TD0.$suggestSolution    = "RGMII1_TD0";
enet_cpsw1.RGMII1.TD1.$suggestSolution    = "RGMII1_TD1";
enet_cpsw1.RGMII1.TD2.$suggestSolution    = "RGMII1_TD2";
enet_cpsw1.RGMII1.TD3.$suggestSolution    = "RGMII1_TD3";
enet_cpsw1.RGMII1.TX_CTL.$suggestSolution = "RGMII1_TX_CTL";
enet_cpsw1.RGMII1.TXC.$suggestSolution    = "RGMII1_TXC";
enet_cpsw1.RGMII2.$suggestSolution        = "RGMII2";
enet_cpsw1.RGMII2.RD0.$suggestSolution    = "VOUT0_HSYNC";
enet_cpsw1.RGMII2.RD1.$suggestSolution    = "VOUT0_DE";
enet_cpsw1.RGMII2.RD2.$suggestSolution    = "VOUT0_VSYNC";
enet_cpsw1.RGMII2.RD3.$suggestSolution    = "VOUT0_PCLK";
enet_cpsw1.RGMII2.RX_CTL.$suggestSolution = "VOUT0_DATA14";
enet_cpsw1.RGMII2.RXC.$suggestSolution    = "VOUT0_DATA15";
enet_cpsw1.RGMII2.TD0.$suggestSolution    = "VOUT0_DATA10";
enet_cpsw1.RGMII2.TD1.$suggestSolution    = "VOUT0_DATA11";
enet_cpsw1.RGMII2.TD2.$suggestSolution    = "VOUT0_DATA12";
enet_cpsw1.RGMII2.TD3.$suggestSolution    = "VOUT0_DATA13";
enet_cpsw1.RGMII2.TX_CTL.$suggestSolution = "VOUT0_DATA8";
enet_cpsw1.RGMII2.TXC.$suggestSolution    = "VOUT0_DATA9";
