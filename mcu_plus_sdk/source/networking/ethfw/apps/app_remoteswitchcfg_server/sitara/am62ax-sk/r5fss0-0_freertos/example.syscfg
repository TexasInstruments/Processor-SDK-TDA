/**
 * @cliArgs --device "AM62Ax" --part "Default" --package "AMB" --context "r5fss0-0" --product "MCU_PLUS_SDK@07.03.01"
 * @versions {"tool":"1.26.2+4477"}
 */

/**
 * Import the modules used in this configuration.
 */
const i2c         = scripting.addModule("/drivers/i2c/i2c", {}, false);
const i2c1        = i2c.addInstance();
const ipc         = scripting.addModule("/drivers/ipc/ipc");
const udma        = scripting.addModule("/drivers/udma/udma", {}, false);
const udma1       = udma.addInstance();
const debug_log   = scripting.addModule("/kernel/dpl/debug_log");
const mpu_armv7   = scripting.addModule("/kernel/dpl/mpu_armv7", {}, false);
const mpu_armv71  = mpu_armv7.addInstance();
const mpu_armv72  = mpu_armv7.addInstance();
const mpu_armv73  = mpu_armv7.addInstance();
const mpu_armv74  = mpu_armv7.addInstance();
const mpu_armv75  = mpu_armv7.addInstance();
const mpu_armv76  = mpu_armv7.addInstance();
const mpu_armv77  = mpu_armv7.addInstance();
const mpu_armv78  = mpu_armv7.addInstance();
const mpu_armv79  = mpu_armv7.addInstance();
const mpu_armv710 = mpu_armv7.addInstance();
const mpu_armv711 = mpu_armv7.addInstance();
const mpu_armv712 = mpu_armv7.addInstance();
const enet_cpsw   = scripting.addModule("/networking/enet_cpsw/enet_cpsw", {}, false);
const enet_cpsw1  = enet_cpsw.addInstance();

/**
 * Write custom configuration values to the imported modules.
 */
i2c1.$name                      = "CONFIG_I2C0";
i2c1.useWakeupDomainPeripherals = false;
i2c1.I2C_child.$name            = "drivers_i2c_v0_i2c_v0_template0";
i2c1.I2C.$assign                = "I2C1";

udma1.$name = "CONFIG_UDMA0";

debug_log.enableUartLog                 = true;
debug_log.enableCssLog                  = false;
debug_log.uartLog.$name                 = "CONFIG_UART0";
debug_log.uartLog.intrEnable            = "DISABLE";
debug_log.uartLog.WKUP_UART.$assign     = "WKUP_USART0";
debug_log.uartLog.WKUP_UART.RXD.$assign = "WKUP_UART0_RXD";
debug_log.uartLog.WKUP_UART.TXD.$assign = "WKUP_UART0_TXD";

mpu_armv71.$name             = "CONFIG_MPU_REGION0";
mpu_armv71.size              = 31;
mpu_armv71.attributes        = "Device";
mpu_armv71.accessPermissions = "Supervisor RD+WR, User RD";
mpu_armv71.allowExecute      = false;

mpu_armv72.$name             = "CONFIG_MPU_REGION1";
mpu_armv72.size              = 15;
mpu_armv72.accessPermissions = "Supervisor RD+WR, User RD";

mpu_armv73.$name             = "CONFIG_MPU_REGION2";
mpu_armv73.baseAddr          = 0x41010000;
mpu_armv73.size              = 15;
mpu_armv73.accessPermissions = "Supervisor RD+WR, User RD";

mpu_armv74.$name             = "CONFIG_MPU_REGION3";
mpu_armv74.accessPermissions = "Supervisor RD+WR, User RD";
mpu_armv74.baseAddr          = 0x79100000;
mpu_armv74.size              = 19;

mpu_armv75.$name             = "CONFIG_MPU_REGION4";
mpu_armv75.baseAddr          = 0x60000000;
mpu_armv75.size              = 28;
mpu_armv75.accessPermissions = "Supervisor RD, User RD";

mpu_armv76.$name    = "CONFIG_MPU_REGION5";
mpu_armv76.baseAddr = 0x80000000;
mpu_armv76.size     = 31;

mpu_armv77.$name        = "LINUX_VRING";
mpu_armv77.attributes   = "NonCached";
mpu_armv77.size         = 20;
mpu_armv77.allowExecute = false;
mpu_armv77.baseAddr     = 0x9C800000;

mpu_armv78.attributes   = "NonCached";
mpu_armv78.size         = 20;
mpu_armv78.allowExecute = false;
mpu_armv78.$name        = "RESOURCE_TABLE_AND_TRACE";
mpu_armv78.baseAddr     = 0x9C900000;

mpu_armv79.allowExecute = false;
mpu_armv79.attributes   = "NonCached";
mpu_armv79.$name        = "RTOS_NORTOS_IPC_VRING";
mpu_armv79.size         = 24;
mpu_armv79.baseAddr     = 0xA0000000;

mpu_armv710.$name        = "FSS0_OSPI0_CTRL_REG";
mpu_armv710.baseAddr     = 0xFC40000;
mpu_armv710.size         = 8;
mpu_armv710.attributes   = "Device";
mpu_armv710.allowExecute = false;

mpu_armv711.$name        = "UART0_REG";
mpu_armv711.baseAddr     = 0x2800000;
mpu_armv711.size         = 9;
mpu_armv711.attributes   = "Device";
mpu_armv711.allowExecute = false;

mpu_armv712.$name      = "INTERCORE_REGION";
mpu_armv712.attributes = "NonCached";
mpu_armv712.baseAddr   = 0xE4000000;
mpu_armv712.size       = 25;

enet_cpsw1.$name                               = "CONFIG_ENET_CPSW0";
enet_cpsw1.IsEthFw                             = true;
enet_cpsw1.PktInfoOnlyEnable                   = true;
enet_cpsw1.cpswVlanAwareMode                   = true;
enet_cpsw1.vlanId_hostPort                     = 0x1;
enet_cpsw1.vlanId_macPort1                     = 0x3;
enet_cpsw1.vlanId_macPort2                     = 0x3;
enet_cpsw1.macport1RxMtu                       = 1522;
enet_cpsw1.macport2RxMtu                       = 1522;
enet_cpsw1.hostportRxMtu                       = 1522;
enet_cpsw1.macAddrConfig                       = "Manual Entry";
enet_cpsw1.macAddrList                         = "70:ff:76:1d:ec:f2,70:ff:76:1d:ec:e3,70:ff:76:1d:ec:e4,70:ff:76:1d:ec:e6,70:ff:76:1d:ec:e7,70:ff:76:1d:ec:e8";
enet_cpsw1.LargePoolPktCount                   = 96;
enet_cpsw1.txDmaChannel.create(2);
enet_cpsw1.txDmaChannel[0].$name               = "ENET_DMA_TX_CH0";
enet_cpsw1.txDmaChannel[1].$name               = "ENET_DMA_TX_CH_PTP";
enet_cpsw1.rxDmaChannel.create(3);
enet_cpsw1.rxDmaChannel[0].$name               = "ENET_DMA_RX_CH0";
enet_cpsw1.rxDmaChannel[0].useGlobalEvt        = true;
enet_cpsw1.rxDmaChannel[1].macAddrCount        = 0;
enet_cpsw1.rxDmaChannel[1].$name               = "ENET_DMA_RX_CH1";
enet_cpsw1.rxDmaChannel[1].useDefaultFlow      = false;
enet_cpsw1.rxDmaChannel[1].useGlobalEvt        = true;
enet_cpsw1.rxDmaChannel[1].PacketsCount        = 16;
enet_cpsw1.rxDmaChannel[2].$name               = "ENET_DMA_RX_CH_PTP";
enet_cpsw1.rxDmaChannel[2].useDefaultFlow      = false;
enet_cpsw1.rxDmaChannel[2].PacketsCount        = 16;
enet_cpsw1.rxDmaChannel[2].useGlobalEvt        = true;
enet_cpsw1.netifInstance.create(1);
enet_cpsw1.netifInstance[0].$name              = "NETIF_INST_ID0";
enet_cpsw1.netifInstance[0].proxyArpRxDmaChNum = ["1"];
enet_cpsw1.netifInstance[0].enableProxyArp     = true;

const ethphy_cpsw_icssg  = scripting.addModule("/board/ethphy_cpsw_icssg/ethphy_cpsw_icssg", {}, false);
const ethphy_cpsw_icssg1 = ethphy_cpsw_icssg.addInstance({}, false);
ethphy_cpsw_icssg1.$name = "CONFIG_ENET_ETHPHY0";
enet_cpsw1.ethphy1       = ethphy_cpsw_icssg1;

const ethphy_cpsw_icssg2 = ethphy_cpsw_icssg.addInstance({}, false);
ethphy_cpsw_icssg2.$name = "CONFIG_ENET_ETHPHY1";
enet_cpsw1.ethphy2       = ethphy_cpsw_icssg2;

const udma2        = udma.addInstance({}, false);
enet_cpsw1.udmaDrv = udma2;

/**
 * Pinmux solution for unlocked pins/peripherals. This ensures that minor changes to the automatic solver in a future
 * version of the tool will not impact the pinmux you originally saw.  These lines can be completely deleted in order to
 * re-solve from scratch.
 */
i2c1.I2C.SCL.$suggestSolution             = "I2C1_SCL";
i2c1.I2C.SDA.$suggestSolution             = "I2C1_SDA";
enet_cpsw1.MDIO.$suggestSolution          = "MDIO0";
enet_cpsw1.MDIO.MDC.$suggestSolution      = "MDIO0_MDC";
enet_cpsw1.MDIO.MDIO.$suggestSolution     = "MDIO0_MDIO";
enet_cpsw1.RGMII1.$suggestSolution        = "RGMII2";
enet_cpsw1.RGMII1.RD0.$suggestSolution    = "RGMII2_RD0";
enet_cpsw1.RGMII1.RD1.$suggestSolution    = "RGMII2_RD1";
enet_cpsw1.RGMII1.RD2.$suggestSolution    = "RGMII2_RD2";
enet_cpsw1.RGMII1.RD3.$suggestSolution    = "RGMII2_RD3";
enet_cpsw1.RGMII1.RX_CTL.$suggestSolution = "RGMII2_RX_CTL";
enet_cpsw1.RGMII1.RXC.$suggestSolution    = "RGMII2_RXC";
enet_cpsw1.RGMII1.TD0.$suggestSolution    = "RGMII2_TD0";
enet_cpsw1.RGMII1.TD1.$suggestSolution    = "RGMII2_TD1";
enet_cpsw1.RGMII1.TD2.$suggestSolution    = "RGMII2_TD2";
enet_cpsw1.RGMII1.TD3.$suggestSolution    = "RGMII2_TD3";
enet_cpsw1.RGMII1.TX_CTL.$suggestSolution = "RGMII2_TX_CTL";
enet_cpsw1.RGMII1.TXC.$suggestSolution    = "RGMII2_TXC";
enet_cpsw1.RGMII2.$suggestSolution        = "RGMII1";
enet_cpsw1.RGMII2.RD0.$suggestSolution    = "RGMII1_RD0";
enet_cpsw1.RGMII2.RD1.$suggestSolution    = "RGMII1_RD1";
enet_cpsw1.RGMII2.RD2.$suggestSolution    = "RGMII1_RD2";
enet_cpsw1.RGMII2.RD3.$suggestSolution    = "RGMII1_RD3";
enet_cpsw1.RGMII2.RX_CTL.$suggestSolution = "RGMII1_RX_CTL";
enet_cpsw1.RGMII2.RXC.$suggestSolution    = "RGMII1_RXC";
enet_cpsw1.RGMII2.TD0.$suggestSolution    = "RGMII1_TD0";
enet_cpsw1.RGMII2.TD1.$suggestSolution    = "RGMII1_TD1";
enet_cpsw1.RGMII2.TD2.$suggestSolution    = "RGMII1_TD2";
enet_cpsw1.RGMII2.TD3.$suggestSolution    = "RGMII1_TD3";
enet_cpsw1.RGMII2.TX_CTL.$suggestSolution = "RGMII1_TX_CTL";
enet_cpsw1.RGMII2.TXC.$suggestSolution    = "RGMII1_TXC";
