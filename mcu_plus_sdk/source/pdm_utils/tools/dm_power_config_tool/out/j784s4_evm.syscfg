/**
 * @cliArgs --device "J784S4_TDA4AP_TDA4VP_TDA4AH_TDA4VH_AM69x" --package "ALY" --part "Default" --product "DM-Configuration-Tool@1.0.0-alpha"
 * @versions {"tool":"1.20.0+3587"}
 */

/**
 * Import the modules used in this configuration.
 */
const dm_power_config  = scripting.addModule("/dm_power_config_tool/dm_power_config", {}, false);
const dm_power_config1 = dm_power_config.addInstance();
const dm_power_config2 = dm_power_config.addInstance();
const dm_power_config3 = dm_power_config.addInstance();

/**
 * Write custom configuration values to the imported modules.
 */
dm_power_config1.$name                                   = "BOARD_ECU_FC";
dm_power_config1.MAIN_C71SS_0                            = 500;
dm_power_config1.enable_MAIN_C71SS_2                     = false;
dm_power_config1.enable_MAIN_C71SS_3                     = false;
dm_power_config1.MAIN_A72SS_0                            = 1000;
dm_power_config1.MAIN_A72SS_1                            = 1000;
dm_power_config1.MAIN_R5FSS_2_1                          = 100;
dm_power_config1.MAIN_R5FSS_2_0                          = 100;
dm_power_config1.MAIN_R5FSS_1_0                          = 100;
dm_power_config1.MAIN_R5FSS_1_1                          = 100;
dm_power_config1.enable_MAIN_C71SS_1                     = false;
dm_power_config1.enable_Graphic_Processing_Unit_0        = false;
dm_power_config1["enable_Video_Encoder/Decoder_1"]       = false;
dm_power_config1.enable_DMPAC_0                          = false;
dm_power_config1.disable_WKUP_GPIO                       = ["TISCI_DEV_WKUP_GPIO0","TISCI_DEV_WKUP_GPIO1"];
dm_power_config1.disable_MCU_CPSW2                       = ["TISCI_DEV_MCU_CPSW0"];
dm_power_config1.disable_WKUP_I2C                        = ["TISCI_DEV_WKUP_I2C0"];
dm_power_config1.disable_MCU_I3C                         = ["TISCI_DEV_MCU_I3C0","TISCI_DEV_MCU_I3C1"];
dm_power_config1.disable_MCU_McSPI                       = ["TISCI_DEV_MCU_MCSPI0","TISCI_DEV_MCU_MCSPI1","TISCI_DEV_MCU_MCSPI2"];
dm_power_config1.disable_MCU_MCAN                        = ["TISCI_DEV_MCU_MCAN0","TISCI_DEV_MCU_MCAN1"];
dm_power_config1.disable_MCU_ADC                         = ["TISCI_DEV_MCU_ADC12FC_16FFC0","TISCI_DEV_MCU_ADC12FC_16FFC1"];
dm_power_config1["disable_MCU_FSS_OSPI_(QSPI)"]          = ["TISCI_DEV_MCU_FSS0_OSPI_0","TISCI_DEV_MCU_FSS0_OSPI_1"];
dm_power_config1["disable_MCU_FSS_0:_OSPI0_/_Hyperbus0"] = ["TISCI_DEV_MCU_FSS0_HYPERBUS1P0_0"];
dm_power_config1.disable_MAIN_USB0                       = ["TISCI_DEV_USB0"];
dm_power_config1["disable_MAIN_DSS_0:_DPI"]              = ["TISCI_DEV_DSS0"];
dm_power_config1.disable_MAIN_MMCSD                      = ["TISCI_DEV_MMCSD0"];
dm_power_config1.disable_MAIN_MCAN                       = ["TISCI_DEV_MCAN0","TISCI_DEV_MCAN1","TISCI_DEV_MCAN10","TISCI_DEV_MCAN11","TISCI_DEV_MCAN12","TISCI_DEV_MCAN13","TISCI_DEV_MCAN14","TISCI_DEV_MCAN15","TISCI_DEV_MCAN16","TISCI_DEV_MCAN17","TISCI_DEV_MCAN2","TISCI_DEV_MCAN3","TISCI_DEV_MCAN4","TISCI_DEV_MCAN5","TISCI_DEV_MCAN6","TISCI_DEV_MCAN7","TISCI_DEV_MCAN8","TISCI_DEV_MCAN9"];
dm_power_config1.disable_MAIN_EQEP                       = ["TISCI_DEV_EQEP0","TISCI_DEV_EQEP1","TISCI_DEV_EQEP2"];
dm_power_config1.disable_MAIN_EPWM                       = ["TISCI_DEV_EPWM0","TISCI_DEV_EPWM1","TISCI_DEV_EPWM2","TISCI_DEV_EPWM3","TISCI_DEV_EPWM4","TISCI_DEV_EPWM5"];
dm_power_config1.disable_MAIN_ECAP                       = ["TISCI_DEV_ECAP0","TISCI_DEV_ECAP1","TISCI_DEV_ECAP2"];
dm_power_config1.disable_MAIN_McASP                      = ["TISCI_DEV_MCASP0","TISCI_DEV_MCASP1","TISCI_DEV_MCASP2","TISCI_DEV_MCASP3","TISCI_DEV_MCASP4"];
dm_power_config1.disable_MAIN_McSPI                      = ["TISCI_DEV_MCSPI0","TISCI_DEV_MCSPI1","TISCI_DEV_MCSPI2","TISCI_DEV_MCSPI3","TISCI_DEV_MCSPI4","TISCI_DEV_MCSPI5","TISCI_DEV_MCSPI6","TISCI_DEV_MCSPI7"];
dm_power_config1.disable_MAIN_CPSW2                      = ["TISCI_DEV_CPSW1"];
dm_power_config1.disable_MAIN_UART                       = ["TISCI_DEV_UART0","TISCI_DEV_UART1","TISCI_DEV_UART2","TISCI_DEV_UART3","TISCI_DEV_UART4","TISCI_DEV_UART5","TISCI_DEV_UART6","TISCI_DEV_UART7"];
dm_power_config1.disable_MAIN_I2C                        = ["TISCI_DEV_I2C0","TISCI_DEV_I2C1","TISCI_DEV_I2C2","TISCI_DEV_I2C3","TISCI_DEV_I2C4","TISCI_DEV_I2C5","TISCI_DEV_I2C6"];
dm_power_config1.disable_MAIN_GPIO                       = ["TISCI_DEV_GPIO0","TISCI_DEV_GPIO2","TISCI_DEV_GPIO4","TISCI_DEV_GPIO6"];
dm_power_config1.disable_MCU_I2C                         = ["TISCI_DEV_MCU_I2C0","TISCI_DEV_MCU_I2C1"];

dm_power_config2.$name                                   = "BOARD_ECU_SRV";
dm_power_config2.MAIN_A72SS_0                            = 500;
dm_power_config2.MAIN_A72SS_1                            = 500;
dm_power_config2.MAIN_C71SS_0                            = 500;
dm_power_config2.MAIN_C71SS_1                            = 500;
dm_power_config2["enable_Video_Encoder/Decoder_1"]       = false;
dm_power_config2["enable_Video_Encoder/Decoder_0"]       = false;
dm_power_config2.enable_MAIN_C71SS_2                     = false;
dm_power_config2.enable_MAIN_C71SS_3                     = false;
dm_power_config2.disable_WKUP_GPIO                       = ["TISCI_DEV_WKUP_GPIO0","TISCI_DEV_WKUP_GPIO1"];
dm_power_config2.disable_MCU_I3C                         = ["TISCI_DEV_MCU_I3C0","TISCI_DEV_MCU_I3C1"];
dm_power_config2.disable_MAIN_MCAN                       = ["TISCI_DEV_MCAN0","TISCI_DEV_MCAN1","TISCI_DEV_MCAN10","TISCI_DEV_MCAN11","TISCI_DEV_MCAN12","TISCI_DEV_MCAN13","TISCI_DEV_MCAN14","TISCI_DEV_MCAN15","TISCI_DEV_MCAN16","TISCI_DEV_MCAN17","TISCI_DEV_MCAN2","TISCI_DEV_MCAN3","TISCI_DEV_MCAN4","TISCI_DEV_MCAN5","TISCI_DEV_MCAN6","TISCI_DEV_MCAN7","TISCI_DEV_MCAN8","TISCI_DEV_MCAN9"];
dm_power_config2.disable_MAIN_McASP                      = ["TISCI_DEV_MCASP0","TISCI_DEV_MCASP1","TISCI_DEV_MCASP2","TISCI_DEV_MCASP3","TISCI_DEV_MCASP4"];
dm_power_config2.disable_MAIN_ECAP                       = ["TISCI_DEV_ECAP0","TISCI_DEV_ECAP1","TISCI_DEV_ECAP2"];
dm_power_config2.disable_MCU_McSPI                       = ["TISCI_DEV_MCU_MCSPI0","TISCI_DEV_MCU_MCSPI1","TISCI_DEV_MCU_MCSPI2"];
dm_power_config2.disable_MCU_MCAN                        = ["TISCI_DEV_MCU_MCAN0","TISCI_DEV_MCU_MCAN1"];
dm_power_config2.disable_MCU_ADC                         = ["TISCI_DEV_MCU_ADC12FC_16FFC0","TISCI_DEV_MCU_ADC12FC_16FFC1"];
dm_power_config2["disable_MCU_FSS_0:_OSPI0_/_Hyperbus0"] = ["TISCI_DEV_MCU_FSS0_HYPERBUS1P0_0"];
dm_power_config2["disable_MCU_FSS_OSPI_(QSPI)"]          = ["TISCI_DEV_MCU_FSS0_OSPI_0","TISCI_DEV_MCU_FSS0_OSPI_1"];
dm_power_config2.disable_MAIN_MMCSD                      = ["TISCI_DEV_MMCSD0"];
dm_power_config2.disable_MAIN_EPWM                       = ["TISCI_DEV_EPWM0","TISCI_DEV_EPWM1","TISCI_DEV_EPWM2","TISCI_DEV_EPWM3","TISCI_DEV_EPWM4","TISCI_DEV_EPWM5"];
dm_power_config2.disable_MAIN_UART                       = ["TISCI_DEV_UART0","TISCI_DEV_UART1","TISCI_DEV_UART2","TISCI_DEV_UART3","TISCI_DEV_UART4","TISCI_DEV_UART5","TISCI_DEV_UART6","TISCI_DEV_UART7","TISCI_DEV_UART9"];
dm_power_config2.disable_MCU_CPSW2                       = ["TISCI_DEV_MCU_CPSW0"];
dm_power_config2.disable_MAIN_EQEP                       = ["TISCI_DEV_EQEP0","TISCI_DEV_EQEP1","TISCI_DEV_EQEP2"];
dm_power_config2["disable_MAIN_DSS_0:_DPI"]              = ["TISCI_DEV_DSS0"];
dm_power_config2.disable_MAIN_CPSW2                      = ["TISCI_DEV_CPSW1"];
dm_power_config2.disable_MAIN_USB0                       = ["TISCI_DEV_USB0"];

dm_power_config3.$name                                   = "BOARD_ECU_AVP4";
dm_power_config3.MAIN_A72SS_1                            = 500;
dm_power_config3.MAIN_A72SS_0                            = 500;
dm_power_config3.enable_MAIN_C71SS_2                     = false;
dm_power_config3.enable_MAIN_C71SS_3                     = false;
dm_power_config3["enable_Video_Encoder/Decoder_0"]       = false;
dm_power_config3["enable_Video_Encoder/Decoder_1"]       = false;
dm_power_config3.disable_WKUP_GPIO                       = ["TISCI_DEV_WKUP_GPIO0","TISCI_DEV_WKUP_GPIO1"];
dm_power_config3.disable_MCU_CPSW2                       = ["TISCI_DEV_MCU_CPSW0"];
dm_power_config3.disable_MCU_I3C                         = ["TISCI_DEV_MCU_I3C0","TISCI_DEV_MCU_I3C1"];
dm_power_config3.disable_MCU_McSPI                       = ["TISCI_DEV_MCU_MCSPI0","TISCI_DEV_MCU_MCSPI1","TISCI_DEV_MCU_MCSPI2"];
dm_power_config3.disable_MCU_MCAN                        = ["TISCI_DEV_MCU_MCAN0","TISCI_DEV_MCU_MCAN1"];
dm_power_config3.disable_MCU_ADC                         = ["TISCI_DEV_MCU_ADC12FC_16FFC0","TISCI_DEV_MCU_ADC12FC_16FFC1"];
dm_power_config3["disable_MCU_FSS_0:_OSPI0_/_Hyperbus0"] = ["TISCI_DEV_MCU_FSS0_HYPERBUS1P0_0"];
dm_power_config3["disable_MCU_FSS_OSPI_(QSPI)"]          = ["TISCI_DEV_MCU_FSS0_OSPI_0","TISCI_DEV_MCU_FSS0_OSPI_1"];
dm_power_config3.disable_MAIN_GPIO                       = ["TISCI_DEV_GPIO0","TISCI_DEV_GPIO2","TISCI_DEV_GPIO4","TISCI_DEV_GPIO6"];
dm_power_config3.disable_MAIN_UART                       = ["TISCI_DEV_UART0","TISCI_DEV_UART1","TISCI_DEV_UART2","TISCI_DEV_UART3","TISCI_DEV_UART4","TISCI_DEV_UART5","TISCI_DEV_UART6","TISCI_DEV_UART7"];
dm_power_config3.disable_MAIN_CPSW2                      = ["TISCI_DEV_CPSW1"];
dm_power_config3.disable_MAIN_McSPI                      = ["TISCI_DEV_MCSPI0","TISCI_DEV_MCSPI1","TISCI_DEV_MCSPI2","TISCI_DEV_MCSPI3","TISCI_DEV_MCSPI4","TISCI_DEV_MCSPI5","TISCI_DEV_MCSPI6","TISCI_DEV_MCSPI7"];
dm_power_config3.disable_MAIN_McASP                      = ["TISCI_DEV_MCASP0","TISCI_DEV_MCASP1","TISCI_DEV_MCASP2","TISCI_DEV_MCASP3","TISCI_DEV_MCASP4"];
dm_power_config3.disable_MAIN_ECAP                       = ["TISCI_DEV_ECAP0","TISCI_DEV_ECAP1","TISCI_DEV_ECAP2"];
dm_power_config3.disable_MAIN_EPWM                       = ["TISCI_DEV_EPWM0","TISCI_DEV_EPWM1","TISCI_DEV_EPWM2","TISCI_DEV_EPWM3","TISCI_DEV_EPWM4","TISCI_DEV_EPWM5"];
dm_power_config3.disable_MAIN_EQEP                       = ["TISCI_DEV_EQEP0","TISCI_DEV_EQEP1","TISCI_DEV_EQEP2"];
dm_power_config3.disable_MAIN_MCAN                       = ["TISCI_DEV_MCAN0","TISCI_DEV_MCAN1","TISCI_DEV_MCAN10","TISCI_DEV_MCAN11","TISCI_DEV_MCAN12","TISCI_DEV_MCAN13","TISCI_DEV_MCAN14","TISCI_DEV_MCAN15","TISCI_DEV_MCAN16","TISCI_DEV_MCAN17","TISCI_DEV_MCAN2","TISCI_DEV_MCAN3","TISCI_DEV_MCAN4","TISCI_DEV_MCAN5","TISCI_DEV_MCAN6","TISCI_DEV_MCAN7","TISCI_DEV_MCAN8","TISCI_DEV_MCAN9"];
dm_power_config3.disable_MAIN_MMCSD                      = ["TISCI_DEV_MMCSD1"];
dm_power_config3["disable_MAIN_DSS_0:_DPI"]              = ["TISCI_DEV_DSS0"];
dm_power_config3.disable_MAIN_USB0                       = ["TISCI_DEV_USB0"];
dm_power_config3.VPAC_0                                  = 600;
dm_power_config3.VPAC_1                                  = 600;
dm_power_config3.DMPAC_0                                 = 240;
dm_power_config3.MAIN_R5FSS_1_0                          = 100;
dm_power_config3.MAIN_R5FSS_1_1                          = 100;
dm_power_config3.MAIN_R5FSS_2_0                          = 100;
dm_power_config3.MAIN_R5FSS_2_1                          = 100;
