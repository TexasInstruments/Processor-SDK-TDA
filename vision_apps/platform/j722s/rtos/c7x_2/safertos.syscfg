/**
 * @cliArgs --device "J722S_TDA4VEN_TDA4AEN_AM67" --package "AMW" --part "Default" --context "c75ss1-0" --product "MCU_PLUS_SDK@07.03.01"
 * @versions {"tool":"1.18.999+112"}
 */

/**
 * Import the modules used in this configuration.
 */
const debug_log   = scripting.addModule("/kernel/dpl/debug_log");
const mmu_armv8   = scripting.addModule("/kernel/dpl/mmu_armv8", {}, false);
const mmu_armv81  = mmu_armv8.addInstance();
const mmu_armv82  = mmu_armv8.addInstance();
const mmu_armv83  = mmu_armv8.addInstance();
const mmu_armv84  = mmu_armv8.addInstance();
const mmu_armv85  = mmu_armv8.addInstance();
const mmu_armv86  = mmu_armv8.addInstance();
const mmu_armv87  = mmu_armv8.addInstance();
const mmu_armv88  = mmu_armv8.addInstance();
const mmu_armv89  = mmu_armv8.addInstance();
const mmu_armv810  = mmu_armv8.addInstance();
const mmu_armv811  = mmu_armv8.addInstance();
const mmu_armv812  = mmu_armv8.addInstance();
const mmu_armv813  = mmu_armv8.addInstance();
const mmu_armv814  = mmu_armv8.addInstance();
const mmu_armv815  = mmu_armv8.addInstance();
const mmu_armv816  = mmu_armv8.addInstance();

/**
 * Write custom configuration values to the imported modules.
 */

debug_log.enableSharedMemLog   = false;
debug_log.enableLogZoneWarning = false;
debug_log.enableLogZoneError   = false;
debug_log.enableUartLog        = false;

/**
 * Register region 0.
 * Region start: 0x0
 * Region end: 0x20000000
 * Read and write for both privileged and user modes.
 * No Execute for both privileged and user modes.
 * Attribute is MAIR0.
 */
mmu_armv81.$name             = "REGISTER_REGION_0";
mmu_armv81.vAddr             = 0x00000000;
mmu_armv81.pAddr             = 0x00000000;
mmu_armv81.size              = 0x20000000;
mmu_armv81.attribute         = "MAIR0";

/**
 * Register region 1.
 * Region start: 0x20000000
 * Region end: 0x40000000
 * Read and write for both privileged and user modes.
 * No Execute for both privileged and user modes.
 * Attribute is MAIR0.
 */
mmu_armv82.$name             = "REGISTER_REGION_1";
mmu_armv82.vAddr             = 0x20000000;
mmu_armv82.pAddr             = 0x20000000;
mmu_armv82.size              = 0x20000000;
mmu_armv82.attribute         = "MAIR0";

/**
 * Register region 2.
 * Region start: 0x40000000
 * Region end: 0x60000000
 * Read and write for both privileged and user modes.
 * No Execute for both privileged and user modes.
 * Attribute is MAIR0.
 */
mmu_armv83.$name             = "REGISTER_REGION_2";
mmu_armv83.vAddr             = 0x40000000;
mmu_armv83.pAddr             = 0x40000000;
mmu_armv83.size              = 0x20000000;
mmu_armv83.attribute         = "MAIR0";

/**
 * FSS region.
 * Region start: 0x60000000
 * Region end: 0x64000000
 * Read and write for both privileged and user modes.
 * No Execute for both privileged and user modes.
 * Attribute is MAIR0.
 */
mmu_armv84.$name             = "FSS0_DAT_REGION";
mmu_armv84.vAddr             = 0x60000000;
mmu_armv84.pAddr             = 0x60000000;
mmu_armv84.size              = 0x4000000;
mmu_armv84.attribute         = "MAIR0";

/**
 * CLEC region.
 * Region start: 0x7D200000
 * Region end: 0x7D200000
 * Read and write for both privileged and user modes.
 * No Execute for both privileged and user modes.
 * Attribute is MAIR0.
 */
mmu_armv85.$name             = "CLEC";
mmu_armv85.vAddr             = 0x7D200000;
mmu_armv85.pAddr             = 0x7D200000;
mmu_armv85.size              = 0x100000;
mmu_armv85.attribute         = "MAIR0";

/**
 * DRU region.
 * Region start: 0x7D400000
 * Region end: 0x7D400000
 * Read and write for both privileged and user modes.
 * No Execute for both privileged and user modes.
 * Attribute is MAIR0.
 */
mmu_armv86.$name             = "DRU";
mmu_armv86.vAddr             = 0x7D400000;
mmu_armv86.pAddr             = 0x7D400000;
mmu_armv86.size              = 0x100000;
mmu_armv86.attribute         = "MAIR0";

/**
 * C7X_2 L2 MAIN
 * Region start: 0x7E200000
 * Region end: 0x7E3FFFFF
 * Read and write for both privileged and user modes.
 * Attribute is MAIR7.
 */
mmu_armv87.$name             = "L2RAM_C7x_2_MAIN";
mmu_armv87.vAddr             = 0x7E200000;
mmu_armv87.pAddr             = 0x7E200000;
mmu_armv87.size              = 0x200000;
mmu_armv87.attribute         = "MAIR7";

/**
 * C7X_2 L2 AUX
 * Region start: 0x7F800000
 * Region end: 0x7F83FFFF
 * Read and write for both privileged and user modes.
 * Attribute is MAIR7.
 */
mmu_armv88.$name             = "L2RAM_C7x_2_AUX";
mmu_armv88.vAddr             = 0x7F800000;
mmu_armv88.pAddr             = 0x7F800000;
mmu_armv88.size              = 0x40000;
mmu_armv88.attribute         = "MAIR7";

/**
 * DDR_C7x_2_DTS
 * Region start: 0xB1100000
 * Region end: 0xB4FFFFFF
 * Read and write for both privileged and user modes.
 * Attribute is MAIR7.
 */
mmu_armv89.$name             = "DDR_C7x_2_DTS";
mmu_armv89.vAddr             = 0xB1100000;
mmu_armv89.pAddr             = 0xB1100000;
mmu_armv89.size              = 0x3F00000;
mmu_armv89.attribute         = "MAIR7";

/**
 * DDR_SHARED_MEM
 * Region start: 0xC0000000
 * Region end: 0xDFFFFFFF
 * Read and write for both privileged and user modes.
 * Attribute is MAIR7.
 */
mmu_armv810.$name             = "DDR_SHARED_MEM";
mmu_armv810.vAddr             = 0xC0000000;
mmu_armv810.pAddr             = 0x900000000;
mmu_armv810.size              = 0x20000000;
mmu_armv810.attribute         = "MAIR7";

/**
 * DDR_SHARED_MEM_NON_CACHE
 * Region start: 0xA5000000
 * Region end: 0xA7C3FFFF
 * Read and write for both privileged and user modes.
 * Attribute is MAIR4.
 */
mmu_armv811.$name             = "DDR_SHARED_MEM_NON_CACHE";
mmu_armv811.vAddr             = 0xA5000000;
mmu_armv811.pAddr             = 0xA5000000;
mmu_armv811.size              = 0x2C40000;
mmu_armv811.attribute         = "MAIR4";

/**
 * DDR_C7x_2_IPC
 * Region start: 0xB1000000
 * Region end: 0xB10FFFFF
 * Read and write for both privileged and user modes.
 * Attribute is MAIR4.
 */
mmu_armv812.$name             = "DDR_C7x_2_IPC";
mmu_armv812.vAddr             = 0xB1000000;
mmu_armv812.pAddr             = 0xB1000000;
mmu_armv812.size              = 0x100000;
mmu_armv812.attribute         = "MAIR4";

/**
 * DDR_C7X_1_HEAP_SCRATCH_NON_CACHEABLE
 * Region start: 0x100000000
 * Region end: 0x107FFFFFF
 * Read and write for both privileged and user modes.
 * Attribute is MAIR4.
 */
mmu_armv813.$name             = "DDR_C7X_1_HEAP_SCRATCH_NON_CACHEABLE";
mmu_armv813.vAddr             = 0x100000000;
mmu_armv813.pAddr             = 0x880000000;
mmu_armv813.size              = 0x8000000;
mmu_armv813.attribute         = "MAIR4";

/**
 * DDR_C7X_1_HEAP_SCRATCH_CACHEABLE
 * Region start: 0x108000000
 * Region end: 0x10FFFFFFF
 * Read and write for both privileged and user modes.
 * Attribute is MAIR7.
 */
mmu_armv814.$name             = "DDR_C7X_1_HEAP_SCRATCH_CACHEABLE";
mmu_armv814.vAddr             = 0x108000000;
mmu_armv814.pAddr             = 0x888000000;
mmu_armv814.size              = 0x8000000;
mmu_armv814.attribute         = "MAIR7";

/**
 * DDR_C7X_2_HEAP_SCRATCH_NON_CACHEABLE
 * Region start: 0x110000000
 * Region end: 0x117FFFFFF
 * Read and write for both privileged and user modes.
 * Attribute is MAIR4.
 */
mmu_armv815.$name             = "DDR_C7X_2_HEAP_SCRATCH_NON_CACHEABLE";
mmu_armv815.vAddr             = 0x110000000;
mmu_armv815.pAddr             = 0x890000000;
mmu_armv815.size              = 0x8000000;
mmu_armv815.attribute         = "MAIR4";

/**
 * DDR_C7X_2_HEAP_SCRATCH_CACHEABLE
 * Region start: 0x118000000
 * Region end: 0x11FFFFFFF
 * Read and write for both privileged and user modes.
 * Attribute is MAIR7.
 */
mmu_armv816.$name             = "DDR_C7X_2_HEAP_SCRATCH_CACHEABLE";
mmu_armv816.vAddr             = 0x118000000;
mmu_armv816.pAddr             = 0x898000000;
mmu_armv816.size              = 0x8000000;
mmu_armv816.attribute         = "MAIR7";
