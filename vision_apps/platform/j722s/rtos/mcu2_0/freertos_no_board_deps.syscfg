/**
 * @cliArgs --device "J722S_TDA4VEN_TDA4AEN_AM67" --package "AMW" --part "Default" --context "main-r5fss0-0" --product "MCU_PLUS_SDK@07.03.01"
 * @versions {"tool":"1.20.0+3562"}
 */

/**
 * Import the modules used in this configuration.
 */
const debug_log  = scripting.addModule("/kernel/dpl/debug_log");
const mpu_armv7  = scripting.addModule("/kernel/dpl/mpu_armv7", {}, false);
const mpu_armv71 = mpu_armv7.addInstance();
const mpu_armv72 = mpu_armv7.addInstance();
const mpu_armv73 = mpu_armv7.addInstance();
const mpu_armv74 = mpu_armv7.addInstance();
const mpu_armv75 = mpu_armv7.addInstance();
const mpu_armv76 = mpu_armv7.addInstance();
const mpu_armv77 = mpu_armv7.addInstance();
const mpu_armv78 = mpu_armv7.addInstance();
const mpu_armv79 = mpu_armv7.addInstance();
const mpu_armv710 = mpu_armv7.addInstance();
const mpu_armv711 = mpu_armv7.addInstance();
const mpu_armv712 = mpu_armv7.addInstance();
const mpu_armv713 = mpu_armv7.addInstance();
const mpu_armv714 = mpu_armv7.addInstance();
const mpu_armv715 = mpu_armv7.addInstance();
const enet_cpsw   = scripting.addModule("/networking/enet_cpsw/enet_cpsw", {}, false);
const enet_cpsw1  = enet_cpsw.addInstance();
const addr_translate  = scripting.addModule("/kernel/dpl/addr_translate", {}, false);
const addr_translate1 = addr_translate.addInstance();

/**
 * Write custom configuration values to the imported modules.
 */
debug_log.enableSharedMemLog   = false;
debug_log.enableLogZoneWarning = false;
debug_log.enableLogZoneError   = false;
debug_log.enableUartLog        = false;


mpu_armv71.baseAddr            = 0x0;
mpu_armv71.size                = 31; /* 2 GB */
mpu_armv71.attributes          = "Device";
mpu_armv71.allowExecute        = false;
mpu_armv71.$name               = "CONFIG_MPU_REGISTER";

mpu_armv72.baseAddr            = 0x0;
mpu_armv72.size                = 15; /* 32 KB */
mpu_armv72.$name               = "CONFIG_MPU_TCMA";
mpu_armv72.allowExecute        = true;
mpu_armv72.attributes          = "NonCached";

mpu_armv73.baseAddr            = 0x41010000;
mpu_armv73.size                = 15; /* 32 KB */
mpu_armv73.$name               = "CONFIG_MPU_TCMB";
mpu_armv73.allowExecute        = true;
mpu_armv73.attributes          = "NonCached";

mpu_armv74.baseAddr            = 0x60000000;
mpu_armv74.size                = 26; /* 64 MB */
mpu_armv74.$name               = "CONFIG_MPU_FLASH";
mpu_armv74.allowExecute        = true;

mpu_armv75.baseAddr            = 0x79100000;
mpu_armv75.size                = 19; /* 512 KB */
mpu_armv75.$name               = "CONFIG_MPU_MCU_MSRAM";
mpu_armv75.allowExecute        = true;

mpu_armv76.baseAddr            = 0x80000000;
mpu_armv76.size                = 31; /* 2 GB */
mpu_armv76.$name               = "CONFIG_MPU_DDR";
mpu_armv76.allowExecute        = true;

mpu_armv77.baseAddr            = 0xA2000000;
mpu_armv77.size                = 20;
mpu_armv77.$name               = "LINUX_VRING";
mpu_armv77.allowExecute        = false;
mpu_armv77.attributes          = "NonCached";

mpu_armv78.baseAddr            = 0xA2100000;
mpu_armv78.size                = 20;
mpu_armv78.allowExecute        = false;
mpu_armv78.$name               = "RESOURCE_TABLE_AND_TRACE";
mpu_armv78.attributes          = "NonCached";

mpu_armv79.baseAddr            = 0xA5000000;
mpu_armv79.size                = 24;
mpu_armv79.allowExecute        = false;
mpu_armv79.$name               = "IPC_VRING_MEM";
mpu_armv79.attributes          = "NonCached";

mpu_armv710.baseAddr           = 0xA6000000;
mpu_armv710.size               = 24;
mpu_armv710.allowExecute       = false;
mpu_armv710.$name              = "TIOVX_LOG_RT_MEM";
mpu_armv710.attributes         = "NonCached";

mpu_armv711.baseAddr           = 0xA7000000;
mpu_armv711.size               = 23;
mpu_armv711.allowExecute       = false;
mpu_armv711.$name              = "TIOVX_OBJ_DESC_MEM";
mpu_armv711.attributes         = "NonCached";

mpu_armv712.baseAddr           = 0xA7800000;
mpu_armv712.size               = 22;
mpu_armv712.allowExecute       = false;
mpu_armv712.$name              = "APP_FILEIO_MEM";
mpu_armv712.attributes         = "NonCached";

mpu_armv713.baseAddr           = 0xA7C00000;
mpu_armv713.size               = 18;
mpu_armv713.allowExecute       = false;
mpu_armv713.$name              = "APP_LOG_MEM";
mpu_armv713.attributes         = "NonCached";

mpu_armv714.baseAddr           = 0xB7800000;
mpu_armv714.size               = 22;
mpu_armv714.allowExecute       = false;
mpu_armv714.$name              = "DDR_MCU2_0_VISS_CONFIG_HEAP";
mpu_armv714.attributes         = "CUSTOM";
mpu_armv714.tex                = 7;
mpu_armv714.isBufferable       = false;
mpu_armv714.isCacheable        = true;

mpu_armv715.baseAddr   = 0xB8000000;
mpu_armv715.size       = 24;
mpu_armv715.allowExecute = false;
mpu_armv715.$name      = "INTERCORE_REGION";
mpu_armv715.attributes = "NonCached";

addr_translate1.$name      = "CONFIG_ADDR_TRANSLATE_REGION0";
addr_translate1.localAddr  = 0xC0000000;
addr_translate1.systemAddr = 0x900000000;

enet_cpsw1.$name                               = "CONFIG_ENET_CPSW0";
enet_cpsw1.IsEthFw                             = true;
enet_cpsw1.macAddrConfig                       = "Manual Entry";
enet_cpsw1.LargePoolPktCount                   = 64;
enet_cpsw1.PktInfoOnlyEnable                   = true;
enet_cpsw1.macAddrList                         = "70:ff:76:1d:ec:f2,70:ff:76:1d:ec:e3,70:ff:76:1d:ec:e4";
enet_cpsw1.cpswVlanAwareMode                   = true;
enet_cpsw1.vlanId_hostPort                     = 0x1;
enet_cpsw1.vlanId_macPort1                     = 0x3;
enet_cpsw1.vlanId_macPort2                     = 0x3;
enet_cpsw1.hostportRxMtu                       = 1522;
enet_cpsw1.RGMII1.$assign                      = "RGMII1";
enet_cpsw1.txDmaChannel.create(2);
enet_cpsw1.txDmaChannel[0].$name               = "ENET_DMA_TX_CH0";
enet_cpsw1.txDmaChannel[1].$name               = "ENET_DMA_TX_CH_PTP";
enet_cpsw1.rxDmaChannel.create(3);
enet_cpsw1.rxDmaChannel[0].$name               = "ENET_DMA_RX_CH0";
enet_cpsw1.rxDmaChannel[0].PacketsCount        = 16;
enet_cpsw1.rxDmaChannel[0].useGlobalEvt        = true;
enet_cpsw1.rxDmaChannel[1].$name               = "ENET_DMA_RX_CH1";
enet_cpsw1.rxDmaChannel[1].macAddrCount        = 0;
enet_cpsw1.rxDmaChannel[1].useDefaultFlow      = false;
enet_cpsw1.rxDmaChannel[1].PacketsCount        = 16;
enet_cpsw1.rxDmaChannel[1].useGlobalEvt        = true;
enet_cpsw1.rxDmaChannel[2].$name               = "ENET_DMA_RX_CH_PTP";
enet_cpsw1.rxDmaChannel[2].useDefaultFlow      = false;
enet_cpsw1.rxDmaChannel[2].PacketsCount        = 16;
enet_cpsw1.rxDmaChannel[2].useGlobalEvt        = true;
enet_cpsw1.rxDmaChannel[2].macAddrCount        = 0;
enet_cpsw1.netifInstance.create(1);
enet_cpsw1.netifInstance[0].$name              = "NETIF_INST_ID0";
enet_cpsw1.netifInstance[0].enableProxyArp     = true;
enet_cpsw1.netifInstance[0].proxyArpRxDmaChNum = ["1"];
enet_cpsw1.DisableMacPort2                     = true;

const ethphy_cpsw_icssg  = scripting.addModule("/board/ethphy_cpsw_icssg/ethphy_cpsw_icssg", {}, false);
const ethphy_cpsw_icssg1 = ethphy_cpsw_icssg.addInstance({}, false);
ethphy_cpsw_icssg1.$name     = "CONFIG_ENET_ETHPHY1";



const udma       = scripting.addModule("/drivers/udma/udma", {}, false);
const udma1      = udma.addInstance();

const udma2        = udma.addInstance({}, false);
enet_cpsw1.udmaDrv = udma2;

/**
 * Pinmux solution for unlocked pins/peripherals. This ensures that minor changes to the automatic solver in a future
 * version of the tool will not impact the pinmux you originally saw.  These lines can be completely deleted in order to
 * re-solve from scratch.
 */
enet_cpsw1.MDIO.$suggestSolution          = "MDIO0";
enet_cpsw1.MDIO.MDC.$suggestSolution      = "MDIO0_MDC";
enet_cpsw1.MDIO.MDIO.$suggestSolution     = "MDIO0_MDIO";
enet_cpsw1.RGMII1.RD0.$suggestSolution    = "RGMII1_RD0";
enet_cpsw1.RGMII1.RD1.$suggestSolution    = "RGMII1_RD1";
enet_cpsw1.RGMII1.RD2.$suggestSolution    = "RGMII1_RD2";
enet_cpsw1.RGMII1.RD3.$suggestSolution    = "RGMII1_RD3";
enet_cpsw1.RGMII1.RX_CTL.$suggestSolution = "RGMII1_RX_CTL";
enet_cpsw1.RGMII1.RXC.$suggestSolution    = "RGMII1_RXC";
enet_cpsw1.RGMII1.TD0.$suggestSolution    = "RGMII1_TD0";
enet_cpsw1.RGMII1.TD1.$suggestSolution    = "RGMII1_TD1";
enet_cpsw1.RGMII1.TD2.$suggestSolution    = "RGMII1_TD2";
enet_cpsw1.RGMII1.TD3.$suggestSolution    = "RGMII1_TD3";
enet_cpsw1.RGMII1.TX_CTL.$suggestSolution = "RGMII1_TX_CTL";
enet_cpsw1.RGMII1.TXC.$suggestSolution    = "RGMII1_TXC";
